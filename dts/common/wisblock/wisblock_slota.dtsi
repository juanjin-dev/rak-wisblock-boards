/*
 * SPDX-License-Identifier: Apache-2.0
 * Copyright (c) 2026 RAKwireless Technology Co., Ltd.
 */

#include <zephyr/dt-bindings/gpio/wisblock-slot-connector.h>

/ {
	wisblock_slota: wisblock_slota {
		compatible = "wisblock-slot-connector";
		#gpio-cells = <2>;
		gpio-map-mask = <0xffffffff 0xffffffc0>;
		gpio-map-pass-thru = <0 0x3f>;
		gpio-map =
			<WISBLOCK_SLOT_TXD	0 &wisblock_io	WISBLOCK_IO_TXD1	0>,
			<WISBLOCK_SLOT_SPI_CS	0 &wisblock_io	WISBLOCK_IO_SPI_CS	0>,
			<WISBLOCK_SLOT_SPI_CLK	0 &wisblock_io	WISBLOCK_IO_SPI_CLK	0>,
			<WISBLOCK_SLOT_SPI_MISO	0 &wisblock_io	WISBLOCK_IO_SPI_MISO	0>,
			<WISBLOCK_SLOT_SPI_MOSI	0 &wisblock_io	WISBLOCK_IO_SPI_MOSI	0>,
			<WISBLOCK_SLOT_I2C_SCL	0 &wisblock_io	WISBLOCK_IO_I2C1_SCL	0>,
			<WISBLOCK_SLOT_I2C_SDA	0 &wisblock_io	WISBLOCK_IO_I2C1_SDA	0>,
			<WISBLOCK_SLOT_GPIO1	0 &wisblock_io	WISBLOCK_IO_IO2		0>,
			<WISBLOCK_SLOT_GPIO2	0 &wisblock_io	WISBLOCK_IO_IO1		0>,
			<WISBLOCK_SLOT_RXD	0 &wisblock_io	WISBLOCK_IO_RXD1	0>;
	};
};