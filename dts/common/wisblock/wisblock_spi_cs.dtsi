/*
 * Copyright (c) 2026 Shenzhen RAKwireless Technology Co., Ltd.
 *
 * SPDX-License-Identifier: Apache-2.0
 */

/**
 * @file
 * @brief SPI chip-select GPIO phandle-array accumulator for WisBlock shields.
 */

/*
 * Usage
 * -----
 * Include this file once per SPI CS signal a shield needs on wisblock_spi.
 * Before each include, define exactly one WISBLOCK_SPI_USE_* activation macro
 * together with its matching _FLAGS macro, then extend wisblock_spi:
 *
 *   #define WISBLOCK_SPI_USE_IO1
 *   #define WISBLOCK_SPI_IO1_FLAGS  (GPIO_ACTIVE_LOW)
 *   #include <wisblock/wisblock_spi_cs.dtsi>
 *
 *   &wisblock_spi {
 *       cs-gpios = WISBLOCK_SPI_CS_GPIOS;
 *       my_dev: my_dev@WISBLOCK_SPI_IO1_IDX {
 *           reg = <WISBLOCK_SPI_IO1_REG>;
 *       };
 *   };
 *
 * Direct IO-pin signals
 * ---------------------
 *   WISBLOCK_SPI_USE_IO1    + WISBLOCK_SPI_IO1_FLAGS    IO1 as CS
 *   WISBLOCK_SPI_USE_IO2    + WISBLOCK_SPI_IO2_FLAGS    IO2 as CS
 *   WISBLOCK_SPI_USE_IO3    + WISBLOCK_SPI_IO3_FLAGS    IO3 as CS
 *   WISBLOCK_SPI_USE_IO4    + WISBLOCK_SPI_IO4_FLAGS    IO4 as CS
 *   WISBLOCK_SPI_USE_IO5    + WISBLOCK_SPI_IO5_FLAGS    IO5 as CS
 *   WISBLOCK_SPI_USE_IO6    + WISBLOCK_SPI_IO6_FLAGS    IO6 as CS
 *   WISBLOCK_SPI_USE_SPI_CS + WISBLOCK_SPI_CS_FLAGS     dedicated SPI CS pin
 *
 * Slot-alias signals (translated to wisblock_io phandle internally)
 * -----------------------------------------------------------------
 *   Slot A: GPIO1 -> IO2, GPIO2 -> IO1
 *   Slot B: GPIO1 -> IO1, GPIO2 -> IO2
 *   Slot C: GPIO1 -> IO4, GPIO2 -> IO3
 *   Slot D: GPIO1 -> IO6, GPIO2 -> IO5
 *   Slot E: GPIO1 -> IO3, GPIO2 -> IO4
 *   Slot F: GPIO1 -> IO5, GPIO2 -> IO6
 *
 *   WISBLOCK_SPI_USE_SLOTA_GPIO1 + WISBLOCK_SPI_SLOTA_GPIO1_FLAGS
 *   WISBLOCK_SPI_USE_SLOTA_GPIO2 + WISBLOCK_SPI_SLOTA_GPIO2_FLAGS
 *   (analogously for slots B through F)
 *
 * How it works
 * ------------
 * Zephyr concatenates all active shield overlays into one translation unit
 * and runs a single C preprocessor pass. This file maintains a running
 * counter WISBLOCK_SPI_CS_COUNT and per-slot cache macros
 * _WISBLOCK_SPI_CS_GPIOS_N. On every include it:
 *
 *   1. Checks whether the requested signal is already registered via its
 *      physical-pin IDX guard, preventing accidental double-allocation.
 *   2. Assigns the next available slot index to the signal.
 *   3. Stores the phandle cell in _WISBLOCK_SPI_CS_GPIOS_N using &wisblock_io
 *      directly so slot-aliased signals resolve without double indirection.
 *   4. Rebuilds WISBLOCK_SPI_CS_GPIOS from all occupied slots.
 *
 * DTS property assignment uses last-writer-wins semantics. The cs-gpios line
 * in the last shield overlay always carries the complete array that covers
 * all earlier shields.
 *
 * If two shields request the same physical IO pin, the second registration
 * block is silently skipped (the IDX guard is already defined). The shield's
 * @<IDX> node-address macro will then be undefined, producing a deterministic
 * DTC error that clearly identifies the conflict.
 *
 * Maximum supported CS entries: 7 (SPI_CS, IO1-IO6).
 */

#ifndef WISBLOCK_SPI_CS_ACCUMULATOR_DEPS
#define WISBLOCK_SPI_CS_ACCUMULATOR_DEPS
#include <zephyr/dt-bindings/gpio/wisblock-io-connector.h>
#endif

/* Running counter -- persists across includes in a single cpp pass */
#ifndef WISBLOCK_SPI_CS_COUNT
# define WISBLOCK_SPI_CS_COUNT 0
#endif

/* IO1 */
#if defined(WISBLOCK_SPI_USE_IO1) && !defined(WISBLOCK_SPI_IO1_IDX)
# if   WISBLOCK_SPI_CS_COUNT == 0
#  define WISBLOCK_SPI_IO1_IDX 0
#  define WISBLOCK_SPI_IO1_REG 0x0
#  define _WISBLOCK_SPI_CS_GPIOS_0 <&wisblock_io WISBLOCK_IO_IO1 WISBLOCK_SPI_IO1_FLAGS>
#  undef  WISBLOCK_SPI_CS_COUNT
#  define WISBLOCK_SPI_CS_COUNT 1
# elif WISBLOCK_SPI_CS_COUNT == 1
#  define WISBLOCK_SPI_IO1_IDX 1
#  define WISBLOCK_SPI_IO1_REG 0x1
#  define _WISBLOCK_SPI_CS_GPIOS_1 <&wisblock_io WISBLOCK_IO_IO1 WISBLOCK_SPI_IO1_FLAGS>
#  undef  WISBLOCK_SPI_CS_COUNT
#  define WISBLOCK_SPI_CS_COUNT 2
# elif WISBLOCK_SPI_CS_COUNT == 2
#  define WISBLOCK_SPI_IO1_IDX 2
#  define WISBLOCK_SPI_IO1_REG 0x2
#  define _WISBLOCK_SPI_CS_GPIOS_2 <&wisblock_io WISBLOCK_IO_IO1 WISBLOCK_SPI_IO1_FLAGS>
#  undef  WISBLOCK_SPI_CS_COUNT
#  define WISBLOCK_SPI_CS_COUNT 3
# elif WISBLOCK_SPI_CS_COUNT == 3
#  define WISBLOCK_SPI_IO1_IDX 3
#  define WISBLOCK_SPI_IO1_REG 0x3
#  define _WISBLOCK_SPI_CS_GPIOS_3 <&wisblock_io WISBLOCK_IO_IO1 WISBLOCK_SPI_IO1_FLAGS>
#  undef  WISBLOCK_SPI_CS_COUNT
#  define WISBLOCK_SPI_CS_COUNT 4
# elif WISBLOCK_SPI_CS_COUNT == 4
#  define WISBLOCK_SPI_IO1_IDX 4
#  define WISBLOCK_SPI_IO1_REG 0x4
#  define _WISBLOCK_SPI_CS_GPIOS_4 <&wisblock_io WISBLOCK_IO_IO1 WISBLOCK_SPI_IO1_FLAGS>
#  undef  WISBLOCK_SPI_CS_COUNT
#  define WISBLOCK_SPI_CS_COUNT 5
# elif WISBLOCK_SPI_CS_COUNT == 5
#  define WISBLOCK_SPI_IO1_IDX 5
#  define WISBLOCK_SPI_IO1_REG 0x5
#  define _WISBLOCK_SPI_CS_GPIOS_5 <&wisblock_io WISBLOCK_IO_IO1 WISBLOCK_SPI_IO1_FLAGS>
#  undef  WISBLOCK_SPI_CS_COUNT
#  define WISBLOCK_SPI_CS_COUNT 6
# elif WISBLOCK_SPI_CS_COUNT == 6
#  define WISBLOCK_SPI_IO1_IDX 6
#  define WISBLOCK_SPI_IO1_REG 0x6
#  define _WISBLOCK_SPI_CS_GPIOS_6 <&wisblock_io WISBLOCK_IO_IO1 WISBLOCK_SPI_IO1_FLAGS>
#  undef  WISBLOCK_SPI_CS_COUNT
#  define WISBLOCK_SPI_CS_COUNT 7
# endif
#endif /* IO1 */

/* IO2 */
#if defined(WISBLOCK_SPI_USE_IO2) && !defined(WISBLOCK_SPI_IO2_IDX)
# if   WISBLOCK_SPI_CS_COUNT == 0
#  define WISBLOCK_SPI_IO2_IDX 0
#  define WISBLOCK_SPI_IO2_REG 0x0
#  define _WISBLOCK_SPI_CS_GPIOS_0 <&wisblock_io WISBLOCK_IO_IO2 WISBLOCK_SPI_IO2_FLAGS>
#  undef  WISBLOCK_SPI_CS_COUNT
#  define WISBLOCK_SPI_CS_COUNT 1
# elif WISBLOCK_SPI_CS_COUNT == 1
#  define WISBLOCK_SPI_IO2_IDX 1
#  define WISBLOCK_SPI_IO2_REG 0x1
#  define _WISBLOCK_SPI_CS_GPIOS_1 <&wisblock_io WISBLOCK_IO_IO2 WISBLOCK_SPI_IO2_FLAGS>
#  undef  WISBLOCK_SPI_CS_COUNT
#  define WISBLOCK_SPI_CS_COUNT 2
# elif WISBLOCK_SPI_CS_COUNT == 2
#  define WISBLOCK_SPI_IO2_IDX 2
#  define WISBLOCK_SPI_IO2_REG 0x2
#  define _WISBLOCK_SPI_CS_GPIOS_2 <&wisblock_io WISBLOCK_IO_IO2 WISBLOCK_SPI_IO2_FLAGS>
#  undef  WISBLOCK_SPI_CS_COUNT
#  define WISBLOCK_SPI_CS_COUNT 3
# elif WISBLOCK_SPI_CS_COUNT == 3
#  define WISBLOCK_SPI_IO2_IDX 3
#  define WISBLOCK_SPI_IO2_REG 0x3
#  define _WISBLOCK_SPI_CS_GPIOS_3 <&wisblock_io WISBLOCK_IO_IO2 WISBLOCK_SPI_IO2_FLAGS>
#  undef  WISBLOCK_SPI_CS_COUNT
#  define WISBLOCK_SPI_CS_COUNT 4
# elif WISBLOCK_SPI_CS_COUNT == 4
#  define WISBLOCK_SPI_IO2_IDX 4
#  define WISBLOCK_SPI_IO2_REG 0x4
#  define _WISBLOCK_SPI_CS_GPIOS_4 <&wisblock_io WISBLOCK_IO_IO2 WISBLOCK_SPI_IO2_FLAGS>
#  undef  WISBLOCK_SPI_CS_COUNT
#  define WISBLOCK_SPI_CS_COUNT 5
# elif WISBLOCK_SPI_CS_COUNT == 5
#  define WISBLOCK_SPI_IO2_IDX 5
#  define WISBLOCK_SPI_IO2_REG 0x5
#  define _WISBLOCK_SPI_CS_GPIOS_5 <&wisblock_io WISBLOCK_IO_IO2 WISBLOCK_SPI_IO2_FLAGS>
#  undef  WISBLOCK_SPI_CS_COUNT
#  define WISBLOCK_SPI_CS_COUNT 6
# elif WISBLOCK_SPI_CS_COUNT == 6
#  define WISBLOCK_SPI_IO2_IDX 6
#  define WISBLOCK_SPI_IO2_REG 0x6
#  define _WISBLOCK_SPI_CS_GPIOS_6 <&wisblock_io WISBLOCK_IO_IO2 WISBLOCK_SPI_IO2_FLAGS>
#  undef  WISBLOCK_SPI_CS_COUNT
#  define WISBLOCK_SPI_CS_COUNT 7
# endif
#endif /* IO2 */

/* IO3 */
#if defined(WISBLOCK_SPI_USE_IO3) && !defined(WISBLOCK_SPI_IO3_IDX)
# if   WISBLOCK_SPI_CS_COUNT == 0
#  define WISBLOCK_SPI_IO3_IDX 0
#  define WISBLOCK_SPI_IO3_REG 0x0
#  define _WISBLOCK_SPI_CS_GPIOS_0 <&wisblock_io WISBLOCK_IO_IO3 WISBLOCK_SPI_IO3_FLAGS>
#  undef  WISBLOCK_SPI_CS_COUNT
#  define WISBLOCK_SPI_CS_COUNT 1
# elif WISBLOCK_SPI_CS_COUNT == 1
#  define WISBLOCK_SPI_IO3_IDX 1
#  define WISBLOCK_SPI_IO3_REG 0x1
#  define _WISBLOCK_SPI_CS_GPIOS_1 <&wisblock_io WISBLOCK_IO_IO3 WISBLOCK_SPI_IO3_FLAGS>
#  undef  WISBLOCK_SPI_CS_COUNT
#  define WISBLOCK_SPI_CS_COUNT 2
# elif WISBLOCK_SPI_CS_COUNT == 2
#  define WISBLOCK_SPI_IO3_IDX 2
#  define WISBLOCK_SPI_IO3_REG 0x2
#  define _WISBLOCK_SPI_CS_GPIOS_2 <&wisblock_io WISBLOCK_IO_IO3 WISBLOCK_SPI_IO3_FLAGS>
#  undef  WISBLOCK_SPI_CS_COUNT
#  define WISBLOCK_SPI_CS_COUNT 3
# elif WISBLOCK_SPI_CS_COUNT == 3
#  define WISBLOCK_SPI_IO3_IDX 3
#  define WISBLOCK_SPI_IO3_REG 0x3
#  define _WISBLOCK_SPI_CS_GPIOS_3 <&wisblock_io WISBLOCK_IO_IO3 WISBLOCK_SPI_IO3_FLAGS>
#  undef  WISBLOCK_SPI_CS_COUNT
#  define WISBLOCK_SPI_CS_COUNT 4
# elif WISBLOCK_SPI_CS_COUNT == 4
#  define WISBLOCK_SPI_IO3_IDX 4
#  define WISBLOCK_SPI_IO3_REG 0x4
#  define _WISBLOCK_SPI_CS_GPIOS_4 <&wisblock_io WISBLOCK_IO_IO3 WISBLOCK_SPI_IO3_FLAGS>
#  undef  WISBLOCK_SPI_CS_COUNT
#  define WISBLOCK_SPI_CS_COUNT 5
# elif WISBLOCK_SPI_CS_COUNT == 5
#  define WISBLOCK_SPI_IO3_IDX 5
#  define WISBLOCK_SPI_IO3_REG 0x5
#  define _WISBLOCK_SPI_CS_GPIOS_5 <&wisblock_io WISBLOCK_IO_IO3 WISBLOCK_SPI_IO3_FLAGS>
#  undef  WISBLOCK_SPI_CS_COUNT
#  define WISBLOCK_SPI_CS_COUNT 6
# elif WISBLOCK_SPI_CS_COUNT == 6
#  define WISBLOCK_SPI_IO3_IDX 6
#  define WISBLOCK_SPI_IO3_REG 0x6
#  define _WISBLOCK_SPI_CS_GPIOS_6 <&wisblock_io WISBLOCK_IO_IO3 WISBLOCK_SPI_IO3_FLAGS>
#  undef  WISBLOCK_SPI_CS_COUNT
#  define WISBLOCK_SPI_CS_COUNT 7
# endif
#endif /* IO3 */

/* IO4 */
#if defined(WISBLOCK_SPI_USE_IO4) && !defined(WISBLOCK_SPI_IO4_IDX)
# if   WISBLOCK_SPI_CS_COUNT == 0
#  define WISBLOCK_SPI_IO4_IDX 0
#  define WISBLOCK_SPI_IO4_REG 0x0
#  define _WISBLOCK_SPI_CS_GPIOS_0 <&wisblock_io WISBLOCK_IO_IO4 WISBLOCK_SPI_IO4_FLAGS>
#  undef  WISBLOCK_SPI_CS_COUNT
#  define WISBLOCK_SPI_CS_COUNT 1
# elif WISBLOCK_SPI_CS_COUNT == 1
#  define WISBLOCK_SPI_IO4_IDX 1
#  define WISBLOCK_SPI_IO4_REG 0x1
#  define _WISBLOCK_SPI_CS_GPIOS_1 <&wisblock_io WISBLOCK_IO_IO4 WISBLOCK_SPI_IO4_FLAGS>
#  undef  WISBLOCK_SPI_CS_COUNT
#  define WISBLOCK_SPI_CS_COUNT 2
# elif WISBLOCK_SPI_CS_COUNT == 2
#  define WISBLOCK_SPI_IO4_IDX 2
#  define WISBLOCK_SPI_IO4_REG 0x2
#  define _WISBLOCK_SPI_CS_GPIOS_2 <&wisblock_io WISBLOCK_IO_IO4 WISBLOCK_SPI_IO4_FLAGS>
#  undef  WISBLOCK_SPI_CS_COUNT
#  define WISBLOCK_SPI_CS_COUNT 3
# elif WISBLOCK_SPI_CS_COUNT == 3
#  define WISBLOCK_SPI_IO4_IDX 3
#  define WISBLOCK_SPI_IO4_REG 0x3
#  define _WISBLOCK_SPI_CS_GPIOS_3 <&wisblock_io WISBLOCK_IO_IO4 WISBLOCK_SPI_IO4_FLAGS>
#  undef  WISBLOCK_SPI_CS_COUNT
#  define WISBLOCK_SPI_CS_COUNT 4
# elif WISBLOCK_SPI_CS_COUNT == 4
#  define WISBLOCK_SPI_IO4_IDX 4
#  define WISBLOCK_SPI_IO4_REG 0x4
#  define _WISBLOCK_SPI_CS_GPIOS_4 <&wisblock_io WISBLOCK_IO_IO4 WISBLOCK_SPI_IO4_FLAGS>
#  undef  WISBLOCK_SPI_CS_COUNT
#  define WISBLOCK_SPI_CS_COUNT 5
# elif WISBLOCK_SPI_CS_COUNT == 5
#  define WISBLOCK_SPI_IO4_IDX 5
#  define WISBLOCK_SPI_IO4_REG 0x5
#  define _WISBLOCK_SPI_CS_GPIOS_5 <&wisblock_io WISBLOCK_IO_IO4 WISBLOCK_SPI_IO4_FLAGS>
#  undef  WISBLOCK_SPI_CS_COUNT
#  define WISBLOCK_SPI_CS_COUNT 6
# elif WISBLOCK_SPI_CS_COUNT == 6
#  define WISBLOCK_SPI_IO4_IDX 6
#  define WISBLOCK_SPI_IO4_REG 0x6
#  define _WISBLOCK_SPI_CS_GPIOS_6 <&wisblock_io WISBLOCK_IO_IO4 WISBLOCK_SPI_IO4_FLAGS>
#  undef  WISBLOCK_SPI_CS_COUNT
#  define WISBLOCK_SPI_CS_COUNT 7
# endif
#endif /* IO4 */

/* IO5 */
#if defined(WISBLOCK_SPI_USE_IO5) && !defined(WISBLOCK_SPI_IO5_IDX)
# if   WISBLOCK_SPI_CS_COUNT == 0
#  define WISBLOCK_SPI_IO5_IDX 0
#  define WISBLOCK_SPI_IO5_REG 0x0
#  define _WISBLOCK_SPI_CS_GPIOS_0 <&wisblock_io WISBLOCK_IO_IO5 WISBLOCK_SPI_IO5_FLAGS>
#  undef  WISBLOCK_SPI_CS_COUNT
#  define WISBLOCK_SPI_CS_COUNT 1
# elif WISBLOCK_SPI_CS_COUNT == 1
#  define WISBLOCK_SPI_IO5_IDX 1
#  define WISBLOCK_SPI_IO5_REG 0x1
#  define _WISBLOCK_SPI_CS_GPIOS_1 <&wisblock_io WISBLOCK_IO_IO5 WISBLOCK_SPI_IO5_FLAGS>
#  undef  WISBLOCK_SPI_CS_COUNT
#  define WISBLOCK_SPI_CS_COUNT 2
# elif WISBLOCK_SPI_CS_COUNT == 2
#  define WISBLOCK_SPI_IO5_IDX 2
#  define WISBLOCK_SPI_IO5_REG 0x2
#  define _WISBLOCK_SPI_CS_GPIOS_2 <&wisblock_io WISBLOCK_IO_IO5 WISBLOCK_SPI_IO5_FLAGS>
#  undef  WISBLOCK_SPI_CS_COUNT
#  define WISBLOCK_SPI_CS_COUNT 3
# elif WISBLOCK_SPI_CS_COUNT == 3
#  define WISBLOCK_SPI_IO5_IDX 3
#  define WISBLOCK_SPI_IO5_REG 0x3
#  define _WISBLOCK_SPI_CS_GPIOS_3 <&wisblock_io WISBLOCK_IO_IO5 WISBLOCK_SPI_IO5_FLAGS>
#  undef  WISBLOCK_SPI_CS_COUNT
#  define WISBLOCK_SPI_CS_COUNT 4
# elif WISBLOCK_SPI_CS_COUNT == 4
#  define WISBLOCK_SPI_IO5_IDX 4
#  define WISBLOCK_SPI_IO5_REG 0x4
#  define _WISBLOCK_SPI_CS_GPIOS_4 <&wisblock_io WISBLOCK_IO_IO5 WISBLOCK_SPI_IO5_FLAGS>
#  undef  WISBLOCK_SPI_CS_COUNT
#  define WISBLOCK_SPI_CS_COUNT 5
# elif WISBLOCK_SPI_CS_COUNT == 5
#  define WISBLOCK_SPI_IO5_IDX 5
#  define WISBLOCK_SPI_IO5_REG 0x5
#  define _WISBLOCK_SPI_CS_GPIOS_5 <&wisblock_io WISBLOCK_IO_IO5 WISBLOCK_SPI_IO5_FLAGS>
#  undef  WISBLOCK_SPI_CS_COUNT
#  define WISBLOCK_SPI_CS_COUNT 6
# elif WISBLOCK_SPI_CS_COUNT == 6
#  define WISBLOCK_SPI_IO5_IDX 6
#  define WISBLOCK_SPI_IO5_REG 0x6
#  define _WISBLOCK_SPI_CS_GPIOS_6 <&wisblock_io WISBLOCK_IO_IO5 WISBLOCK_SPI_IO5_FLAGS>
#  undef  WISBLOCK_SPI_CS_COUNT
#  define WISBLOCK_SPI_CS_COUNT 7
# endif
#endif /* IO5 */

/* IO6 */
#if defined(WISBLOCK_SPI_USE_IO6) && !defined(WISBLOCK_SPI_IO6_IDX)
# if   WISBLOCK_SPI_CS_COUNT == 0
#  define WISBLOCK_SPI_IO6_IDX 0
#  define WISBLOCK_SPI_IO6_REG 0x0
#  define _WISBLOCK_SPI_CS_GPIOS_0 <&wisblock_io WISBLOCK_IO_IO6 WISBLOCK_SPI_IO6_FLAGS>
#  undef  WISBLOCK_SPI_CS_COUNT
#  define WISBLOCK_SPI_CS_COUNT 1
# elif WISBLOCK_SPI_CS_COUNT == 1
#  define WISBLOCK_SPI_IO6_IDX 1
#  define WISBLOCK_SPI_IO6_REG 0x1
#  define _WISBLOCK_SPI_CS_GPIOS_1 <&wisblock_io WISBLOCK_IO_IO6 WISBLOCK_SPI_IO6_FLAGS>
#  undef  WISBLOCK_SPI_CS_COUNT
#  define WISBLOCK_SPI_CS_COUNT 2
# elif WISBLOCK_SPI_CS_COUNT == 2
#  define WISBLOCK_SPI_IO6_IDX 2
#  define WISBLOCK_SPI_IO6_REG 0x2
#  define _WISBLOCK_SPI_CS_GPIOS_2 <&wisblock_io WISBLOCK_IO_IO6 WISBLOCK_SPI_IO6_FLAGS>
#  undef  WISBLOCK_SPI_CS_COUNT
#  define WISBLOCK_SPI_CS_COUNT 3
# elif WISBLOCK_SPI_CS_COUNT == 3
#  define WISBLOCK_SPI_IO6_IDX 3
#  define WISBLOCK_SPI_IO6_REG 0x3
#  define _WISBLOCK_SPI_CS_GPIOS_3 <&wisblock_io WISBLOCK_IO_IO6 WISBLOCK_SPI_IO6_FLAGS>
#  undef  WISBLOCK_SPI_CS_COUNT
#  define WISBLOCK_SPI_CS_COUNT 4
# elif WISBLOCK_SPI_CS_COUNT == 4
#  define WISBLOCK_SPI_IO6_IDX 4
#  define WISBLOCK_SPI_IO6_REG 0x4
#  define _WISBLOCK_SPI_CS_GPIOS_4 <&wisblock_io WISBLOCK_IO_IO6 WISBLOCK_SPI_IO6_FLAGS>
#  undef  WISBLOCK_SPI_CS_COUNT
#  define WISBLOCK_SPI_CS_COUNT 5
# elif WISBLOCK_SPI_CS_COUNT == 5
#  define WISBLOCK_SPI_IO6_IDX 5
#  define WISBLOCK_SPI_IO6_REG 0x5
#  define _WISBLOCK_SPI_CS_GPIOS_5 <&wisblock_io WISBLOCK_IO_IO6 WISBLOCK_SPI_IO6_FLAGS>
#  undef  WISBLOCK_SPI_CS_COUNT
#  define WISBLOCK_SPI_CS_COUNT 6
# elif WISBLOCK_SPI_CS_COUNT == 6
#  define WISBLOCK_SPI_IO6_IDX 6
#  define WISBLOCK_SPI_IO6_REG 0x6
#  define _WISBLOCK_SPI_CS_GPIOS_6 <&wisblock_io WISBLOCK_IO_IO6 WISBLOCK_SPI_IO6_FLAGS>
#  undef  WISBLOCK_SPI_CS_COUNT
#  define WISBLOCK_SPI_CS_COUNT 7
# endif
#endif /* IO6 */

/* Dedicated SPI CS pin */
#if defined(WISBLOCK_SPI_USE_SPI_CS) && !defined(WISBLOCK_SPI_CS_IDX)
# if   WISBLOCK_SPI_CS_COUNT == 0
#  define WISBLOCK_SPI_CS_IDX 0
#  define WISBLOCK_SPI_CS_REG 0x0
#  define _WISBLOCK_SPI_CS_GPIOS_0 <&wisblock_io WISBLOCK_IO_SPI_CS WISBLOCK_SPI_CS_FLAGS>
#  undef  WISBLOCK_SPI_CS_COUNT
#  define WISBLOCK_SPI_CS_COUNT 1
# elif WISBLOCK_SPI_CS_COUNT == 1
#  define WISBLOCK_SPI_CS_IDX 1
#  define WISBLOCK_SPI_CS_REG 0x1
#  define _WISBLOCK_SPI_CS_GPIOS_1 <&wisblock_io WISBLOCK_IO_SPI_CS WISBLOCK_SPI_CS_FLAGS>
#  undef  WISBLOCK_SPI_CS_COUNT
#  define WISBLOCK_SPI_CS_COUNT 2
# elif WISBLOCK_SPI_CS_COUNT == 2
#  define WISBLOCK_SPI_CS_IDX 2
#  define WISBLOCK_SPI_CS_REG 0x2
#  define _WISBLOCK_SPI_CS_GPIOS_2 <&wisblock_io WISBLOCK_IO_SPI_CS WISBLOCK_SPI_CS_FLAGS>
#  undef  WISBLOCK_SPI_CS_COUNT
#  define WISBLOCK_SPI_CS_COUNT 3
# elif WISBLOCK_SPI_CS_COUNT == 3
#  define WISBLOCK_SPI_CS_IDX 3
#  define WISBLOCK_SPI_CS_REG 0x3
#  define _WISBLOCK_SPI_CS_GPIOS_3 <&wisblock_io WISBLOCK_IO_SPI_CS WISBLOCK_SPI_CS_FLAGS>
#  undef  WISBLOCK_SPI_CS_COUNT
#  define WISBLOCK_SPI_CS_COUNT 4
# elif WISBLOCK_SPI_CS_COUNT == 4
#  define WISBLOCK_SPI_CS_IDX 4
#  define WISBLOCK_SPI_CS_REG 0x4
#  define _WISBLOCK_SPI_CS_GPIOS_4 <&wisblock_io WISBLOCK_IO_SPI_CS WISBLOCK_SPI_CS_FLAGS>
#  undef  WISBLOCK_SPI_CS_COUNT
#  define WISBLOCK_SPI_CS_COUNT 5
# elif WISBLOCK_SPI_CS_COUNT == 5
#  define WISBLOCK_SPI_CS_IDX 5
#  define WISBLOCK_SPI_CS_REG 0x5
#  define _WISBLOCK_SPI_CS_GPIOS_5 <&wisblock_io WISBLOCK_IO_SPI_CS WISBLOCK_SPI_CS_FLAGS>
#  undef  WISBLOCK_SPI_CS_COUNT
#  define WISBLOCK_SPI_CS_COUNT 6
# elif WISBLOCK_SPI_CS_COUNT == 6
#  define WISBLOCK_SPI_CS_IDX 6
#  define WISBLOCK_SPI_CS_REG 0x6
#  define _WISBLOCK_SPI_CS_GPIOS_6 <&wisblock_io WISBLOCK_IO_SPI_CS WISBLOCK_SPI_CS_FLAGS>
#  undef  WISBLOCK_SPI_CS_COUNT
#  define WISBLOCK_SPI_CS_COUNT 7
# endif
#endif /* SPI_CS */

/*
 * Slot GPIO alias blocks
 * ----------------------
 *
 * Each alias block checks its physical-pin IDX guard before registering.
 * The alias-specific IDX/REG macros are set alongside the physical-pin
 * guard so the shield can reference @WISBLOCK_SPI_SLOT*_GPIO*_IDX.
 */

/* Slot A GPIO1 -> IO2 */
#if defined(WISBLOCK_SPI_USE_SLOTA_GPIO1) && !defined(WISBLOCK_SPI_SLOTA_GPIO1_IDX)
# ifndef WISBLOCK_SPI_IO2_IDX
#  if   WISBLOCK_SPI_CS_COUNT == 0
#   define WISBLOCK_SPI_IO2_IDX          0
#   define WISBLOCK_SPI_SLOTA_GPIO1_IDX  0
#   define WISBLOCK_SPI_SLOTA_GPIO1_REG  0x0
#   define _WISBLOCK_SPI_CS_GPIOS_0 <&wisblock_io WISBLOCK_IO_IO2 WISBLOCK_SPI_SLOTA_GPIO1_FLAGS>
#   undef  WISBLOCK_SPI_CS_COUNT
#   define WISBLOCK_SPI_CS_COUNT 1
#  elif WISBLOCK_SPI_CS_COUNT == 1
#   define WISBLOCK_SPI_IO2_IDX          1
#   define WISBLOCK_SPI_SLOTA_GPIO1_IDX  1
#   define WISBLOCK_SPI_SLOTA_GPIO1_REG  0x1
#   define _WISBLOCK_SPI_CS_GPIOS_1 <&wisblock_io WISBLOCK_IO_IO2 WISBLOCK_SPI_SLOTA_GPIO1_FLAGS>
#   undef  WISBLOCK_SPI_CS_COUNT
#   define WISBLOCK_SPI_CS_COUNT 2
#  elif WISBLOCK_SPI_CS_COUNT == 2
#   define WISBLOCK_SPI_IO2_IDX          2
#   define WISBLOCK_SPI_SLOTA_GPIO1_IDX  2
#   define WISBLOCK_SPI_SLOTA_GPIO1_REG  0x2
#   define _WISBLOCK_SPI_CS_GPIOS_2 <&wisblock_io WISBLOCK_IO_IO2 WISBLOCK_SPI_SLOTA_GPIO1_FLAGS>
#   undef  WISBLOCK_SPI_CS_COUNT
#   define WISBLOCK_SPI_CS_COUNT 3
#  elif WISBLOCK_SPI_CS_COUNT == 3
#   define WISBLOCK_SPI_IO2_IDX          3
#   define WISBLOCK_SPI_SLOTA_GPIO1_IDX  3
#   define WISBLOCK_SPI_SLOTA_GPIO1_REG  0x3
#   define _WISBLOCK_SPI_CS_GPIOS_3 <&wisblock_io WISBLOCK_IO_IO2 WISBLOCK_SPI_SLOTA_GPIO1_FLAGS>
#   undef  WISBLOCK_SPI_CS_COUNT
#   define WISBLOCK_SPI_CS_COUNT 4
#  elif WISBLOCK_SPI_CS_COUNT == 4
#   define WISBLOCK_SPI_IO2_IDX          4
#   define WISBLOCK_SPI_SLOTA_GPIO1_IDX  4
#   define WISBLOCK_SPI_SLOTA_GPIO1_REG  0x4
#   define _WISBLOCK_SPI_CS_GPIOS_4 <&wisblock_io WISBLOCK_IO_IO2 WISBLOCK_SPI_SLOTA_GPIO1_FLAGS>
#   undef  WISBLOCK_SPI_CS_COUNT
#   define WISBLOCK_SPI_CS_COUNT 5
#  elif WISBLOCK_SPI_CS_COUNT == 5
#   define WISBLOCK_SPI_IO2_IDX          5
#   define WISBLOCK_SPI_SLOTA_GPIO1_IDX  5
#   define WISBLOCK_SPI_SLOTA_GPIO1_REG  0x5
#   define _WISBLOCK_SPI_CS_GPIOS_5 <&wisblock_io WISBLOCK_IO_IO2 WISBLOCK_SPI_SLOTA_GPIO1_FLAGS>
#   undef  WISBLOCK_SPI_CS_COUNT
#   define WISBLOCK_SPI_CS_COUNT 6
#  elif WISBLOCK_SPI_CS_COUNT == 6
#   define WISBLOCK_SPI_IO2_IDX          6
#   define WISBLOCK_SPI_SLOTA_GPIO1_IDX  6
#   define WISBLOCK_SPI_SLOTA_GPIO1_REG  0x6
#   define _WISBLOCK_SPI_CS_GPIOS_6 <&wisblock_io WISBLOCK_IO_IO2 WISBLOCK_SPI_SLOTA_GPIO1_FLAGS>
#   undef  WISBLOCK_SPI_CS_COUNT
#   define WISBLOCK_SPI_CS_COUNT 7
#  endif
# endif /* !WISBLOCK_SPI_IO2_IDX */
#endif /* SLOTA_GPIO1 */

/* Slot A GPIO2 -> IO1 */
#if defined(WISBLOCK_SPI_USE_SLOTA_GPIO2) && !defined(WISBLOCK_SPI_SLOTA_GPIO2_IDX)
# ifndef WISBLOCK_SPI_IO1_IDX
#  if   WISBLOCK_SPI_CS_COUNT == 0
#   define WISBLOCK_SPI_IO1_IDX          0
#   define WISBLOCK_SPI_SLOTA_GPIO2_IDX  0
#   define WISBLOCK_SPI_SLOTA_GPIO2_REG  0x0
#   define _WISBLOCK_SPI_CS_GPIOS_0 <&wisblock_io WISBLOCK_IO_IO1 WISBLOCK_SPI_SLOTA_GPIO2_FLAGS>
#   undef  WISBLOCK_SPI_CS_COUNT
#   define WISBLOCK_SPI_CS_COUNT 1
#  elif WISBLOCK_SPI_CS_COUNT == 1
#   define WISBLOCK_SPI_IO1_IDX          1
#   define WISBLOCK_SPI_SLOTA_GPIO2_IDX  1
#   define WISBLOCK_SPI_SLOTA_GPIO2_REG  0x1
#   define _WISBLOCK_SPI_CS_GPIOS_1 <&wisblock_io WISBLOCK_IO_IO1 WISBLOCK_SPI_SLOTA_GPIO2_FLAGS>
#   undef  WISBLOCK_SPI_CS_COUNT
#   define WISBLOCK_SPI_CS_COUNT 2
#  elif WISBLOCK_SPI_CS_COUNT == 2
#   define WISBLOCK_SPI_IO1_IDX          2
#   define WISBLOCK_SPI_SLOTA_GPIO2_IDX  2
#   define WISBLOCK_SPI_SLOTA_GPIO2_REG  0x2
#   define _WISBLOCK_SPI_CS_GPIOS_2 <&wisblock_io WISBLOCK_IO_IO1 WISBLOCK_SPI_SLOTA_GPIO2_FLAGS>
#   undef  WISBLOCK_SPI_CS_COUNT
#   define WISBLOCK_SPI_CS_COUNT 3
#  elif WISBLOCK_SPI_CS_COUNT == 3
#   define WISBLOCK_SPI_IO1_IDX          3
#   define WISBLOCK_SPI_SLOTA_GPIO2_IDX  3
#   define WISBLOCK_SPI_SLOTA_GPIO2_REG  0x3
#   define _WISBLOCK_SPI_CS_GPIOS_3 <&wisblock_io WISBLOCK_IO_IO1 WISBLOCK_SPI_SLOTA_GPIO2_FLAGS>
#   undef  WISBLOCK_SPI_CS_COUNT
#   define WISBLOCK_SPI_CS_COUNT 4
#  elif WISBLOCK_SPI_CS_COUNT == 4
#   define WISBLOCK_SPI_IO1_IDX          4
#   define WISBLOCK_SPI_SLOTA_GPIO2_IDX  4
#   define WISBLOCK_SPI_SLOTA_GPIO2_REG  0x4
#   define _WISBLOCK_SPI_CS_GPIOS_4 <&wisblock_io WISBLOCK_IO_IO1 WISBLOCK_SPI_SLOTA_GPIO2_FLAGS>
#   undef  WISBLOCK_SPI_CS_COUNT
#   define WISBLOCK_SPI_CS_COUNT 5
#  elif WISBLOCK_SPI_CS_COUNT == 5
#   define WISBLOCK_SPI_IO1_IDX          5
#   define WISBLOCK_SPI_SLOTA_GPIO2_IDX  5
#   define WISBLOCK_SPI_SLOTA_GPIO2_REG  0x5
#   define _WISBLOCK_SPI_CS_GPIOS_5 <&wisblock_io WISBLOCK_IO_IO1 WISBLOCK_SPI_SLOTA_GPIO2_FLAGS>
#   undef  WISBLOCK_SPI_CS_COUNT
#   define WISBLOCK_SPI_CS_COUNT 6
#  elif WISBLOCK_SPI_CS_COUNT == 6
#   define WISBLOCK_SPI_IO1_IDX          6
#   define WISBLOCK_SPI_SLOTA_GPIO2_IDX  6
#   define WISBLOCK_SPI_SLOTA_GPIO2_REG  0x6
#   define _WISBLOCK_SPI_CS_GPIOS_6 <&wisblock_io WISBLOCK_IO_IO1 WISBLOCK_SPI_SLOTA_GPIO2_FLAGS>
#   undef  WISBLOCK_SPI_CS_COUNT
#   define WISBLOCK_SPI_CS_COUNT 7
#  endif
# endif /* !WISBLOCK_SPI_IO1_IDX */
#endif /* SLOTA_GPIO2 */

/* Slot B GPIO1 -> IO1 */
#if defined(WISBLOCK_SPI_USE_SLOTB_GPIO1) && !defined(WISBLOCK_SPI_SLOTB_GPIO1_IDX)
# ifndef WISBLOCK_SPI_IO1_IDX
#  if   WISBLOCK_SPI_CS_COUNT == 0
#   define WISBLOCK_SPI_IO1_IDX          0
#   define WISBLOCK_SPI_SLOTB_GPIO1_IDX  0
#   define WISBLOCK_SPI_SLOTB_GPIO1_REG  0x0
#   define _WISBLOCK_SPI_CS_GPIOS_0 <&wisblock_io WISBLOCK_IO_IO1 WISBLOCK_SPI_SLOTB_GPIO1_FLAGS>
#   undef  WISBLOCK_SPI_CS_COUNT
#   define WISBLOCK_SPI_CS_COUNT 1
#  elif WISBLOCK_SPI_CS_COUNT == 1
#   define WISBLOCK_SPI_IO1_IDX          1
#   define WISBLOCK_SPI_SLOTB_GPIO1_IDX  1
#   define WISBLOCK_SPI_SLOTB_GPIO1_REG  0x1
#   define _WISBLOCK_SPI_CS_GPIOS_1 <&wisblock_io WISBLOCK_IO_IO1 WISBLOCK_SPI_SLOTB_GPIO1_FLAGS>
#   undef  WISBLOCK_SPI_CS_COUNT
#   define WISBLOCK_SPI_CS_COUNT 2
#  elif WISBLOCK_SPI_CS_COUNT == 2
#   define WISBLOCK_SPI_IO1_IDX          2
#   define WISBLOCK_SPI_SLOTB_GPIO1_IDX  2
#   define WISBLOCK_SPI_SLOTB_GPIO1_REG  0x2
#   define _WISBLOCK_SPI_CS_GPIOS_2 <&wisblock_io WISBLOCK_IO_IO1 WISBLOCK_SPI_SLOTB_GPIO1_FLAGS>
#   undef  WISBLOCK_SPI_CS_COUNT
#   define WISBLOCK_SPI_CS_COUNT 3
#  elif WISBLOCK_SPI_CS_COUNT == 3
#   define WISBLOCK_SPI_IO1_IDX          3
#   define WISBLOCK_SPI_SLOTB_GPIO1_IDX  3
#   define WISBLOCK_SPI_SLOTB_GPIO1_REG  0x3
#   define _WISBLOCK_SPI_CS_GPIOS_3 <&wisblock_io WISBLOCK_IO_IO1 WISBLOCK_SPI_SLOTB_GPIO1_FLAGS>
#   undef  WISBLOCK_SPI_CS_COUNT
#   define WISBLOCK_SPI_CS_COUNT 4
#  elif WISBLOCK_SPI_CS_COUNT == 4
#   define WISBLOCK_SPI_IO1_IDX          4
#   define WISBLOCK_SPI_SLOTB_GPIO1_IDX  4
#   define WISBLOCK_SPI_SLOTB_GPIO1_REG  0x4
#   define _WISBLOCK_SPI_CS_GPIOS_4 <&wisblock_io WISBLOCK_IO_IO1 WISBLOCK_SPI_SLOTB_GPIO1_FLAGS>
#   undef  WISBLOCK_SPI_CS_COUNT
#   define WISBLOCK_SPI_CS_COUNT 5
#  elif WISBLOCK_SPI_CS_COUNT == 5
#   define WISBLOCK_SPI_IO1_IDX          5
#   define WISBLOCK_SPI_SLOTB_GPIO1_IDX  5
#   define WISBLOCK_SPI_SLOTB_GPIO1_REG  0x5
#   define _WISBLOCK_SPI_CS_GPIOS_5 <&wisblock_io WISBLOCK_IO_IO1 WISBLOCK_SPI_SLOTB_GPIO1_FLAGS>
#   undef  WISBLOCK_SPI_CS_COUNT
#   define WISBLOCK_SPI_CS_COUNT 6
#  elif WISBLOCK_SPI_CS_COUNT == 6
#   define WISBLOCK_SPI_IO1_IDX          6
#   define WISBLOCK_SPI_SLOTB_GPIO1_IDX  6
#   define WISBLOCK_SPI_SLOTB_GPIO1_REG  0x6
#   define _WISBLOCK_SPI_CS_GPIOS_6 <&wisblock_io WISBLOCK_IO_IO1 WISBLOCK_SPI_SLOTB_GPIO1_FLAGS>
#   undef  WISBLOCK_SPI_CS_COUNT
#   define WISBLOCK_SPI_CS_COUNT 7
#  endif
# endif /* !WISBLOCK_SPI_IO1_IDX */
#endif /* SLOTB_GPIO1 */

/* Slot B GPIO2 -> IO2 */
#if defined(WISBLOCK_SPI_USE_SLOTB_GPIO2) && !defined(WISBLOCK_SPI_SLOTB_GPIO2_IDX)
# ifndef WISBLOCK_SPI_IO2_IDX
#  if   WISBLOCK_SPI_CS_COUNT == 0
#   define WISBLOCK_SPI_IO2_IDX          0
#   define WISBLOCK_SPI_SLOTB_GPIO2_IDX  0
#   define WISBLOCK_SPI_SLOTB_GPIO2_REG  0x0
#   define _WISBLOCK_SPI_CS_GPIOS_0 <&wisblock_io WISBLOCK_IO_IO2 WISBLOCK_SPI_SLOTB_GPIO2_FLAGS>
#   undef  WISBLOCK_SPI_CS_COUNT
#   define WISBLOCK_SPI_CS_COUNT 1
#  elif WISBLOCK_SPI_CS_COUNT == 1
#   define WISBLOCK_SPI_IO2_IDX          1
#   define WISBLOCK_SPI_SLOTB_GPIO2_IDX  1
#   define WISBLOCK_SPI_SLOTB_GPIO2_REG  0x1
#   define _WISBLOCK_SPI_CS_GPIOS_1 <&wisblock_io WISBLOCK_IO_IO2 WISBLOCK_SPI_SLOTB_GPIO2_FLAGS>
#   undef  WISBLOCK_SPI_CS_COUNT
#   define WISBLOCK_SPI_CS_COUNT 2
#  elif WISBLOCK_SPI_CS_COUNT == 2
#   define WISBLOCK_SPI_IO2_IDX          2
#   define WISBLOCK_SPI_SLOTB_GPIO2_IDX  2
#   define WISBLOCK_SPI_SLOTB_GPIO2_REG  0x2
#   define _WISBLOCK_SPI_CS_GPIOS_2 <&wisblock_io WISBLOCK_IO_IO2 WISBLOCK_SPI_SLOTB_GPIO2_FLAGS>
#   undef  WISBLOCK_SPI_CS_COUNT
#   define WISBLOCK_SPI_CS_COUNT 3
#  elif WISBLOCK_SPI_CS_COUNT == 3
#   define WISBLOCK_SPI_IO2_IDX          3
#   define WISBLOCK_SPI_SLOTB_GPIO2_IDX  3
#   define WISBLOCK_SPI_SLOTB_GPIO2_REG  0x3
#   define _WISBLOCK_SPI_CS_GPIOS_3 <&wisblock_io WISBLOCK_IO_IO2 WISBLOCK_SPI_SLOTB_GPIO2_FLAGS>
#   undef  WISBLOCK_SPI_CS_COUNT
#   define WISBLOCK_SPI_CS_COUNT 4
#  elif WISBLOCK_SPI_CS_COUNT == 4
#   define WISBLOCK_SPI_IO2_IDX          4
#   define WISBLOCK_SPI_SLOTB_GPIO2_IDX  4
#   define WISBLOCK_SPI_SLOTB_GPIO2_REG  0x4
#   define _WISBLOCK_SPI_CS_GPIOS_4 <&wisblock_io WISBLOCK_IO_IO2 WISBLOCK_SPI_SLOTB_GPIO2_FLAGS>
#   undef  WISBLOCK_SPI_CS_COUNT
#   define WISBLOCK_SPI_CS_COUNT 5
#  elif WISBLOCK_SPI_CS_COUNT == 5
#   define WISBLOCK_SPI_IO2_IDX          5
#   define WISBLOCK_SPI_SLOTB_GPIO2_IDX  5
#   define WISBLOCK_SPI_SLOTB_GPIO2_REG  0x5
#   define _WISBLOCK_SPI_CS_GPIOS_5 <&wisblock_io WISBLOCK_IO_IO2 WISBLOCK_SPI_SLOTB_GPIO2_FLAGS>
#   undef  WISBLOCK_SPI_CS_COUNT
#   define WISBLOCK_SPI_CS_COUNT 6
#  elif WISBLOCK_SPI_CS_COUNT == 6
#   define WISBLOCK_SPI_IO2_IDX          6
#   define WISBLOCK_SPI_SLOTB_GPIO2_IDX  6
#   define WISBLOCK_SPI_SLOTB_GPIO2_REG  0x6
#   define _WISBLOCK_SPI_CS_GPIOS_6 <&wisblock_io WISBLOCK_IO_IO2 WISBLOCK_SPI_SLOTB_GPIO2_FLAGS>
#   undef  WISBLOCK_SPI_CS_COUNT
#   define WISBLOCK_SPI_CS_COUNT 7
#  endif
# endif /* !WISBLOCK_SPI_IO2_IDX */
#endif /* SLOTB_GPIO2 */

/* Slot C GPIO1 -> IO4 */
#if defined(WISBLOCK_SPI_USE_SLOTC_GPIO1) && !defined(WISBLOCK_SPI_SLOTC_GPIO1_IDX)
# ifndef WISBLOCK_SPI_IO4_IDX
#  if   WISBLOCK_SPI_CS_COUNT == 0
#   define WISBLOCK_SPI_IO4_IDX          0
#   define WISBLOCK_SPI_SLOTC_GPIO1_IDX  0
#   define WISBLOCK_SPI_SLOTC_GPIO1_REG  0x0
#   define _WISBLOCK_SPI_CS_GPIOS_0 <&wisblock_io WISBLOCK_IO_IO4 WISBLOCK_SPI_SLOTC_GPIO1_FLAGS>
#   undef  WISBLOCK_SPI_CS_COUNT
#   define WISBLOCK_SPI_CS_COUNT 1
#  elif WISBLOCK_SPI_CS_COUNT == 1
#   define WISBLOCK_SPI_IO4_IDX          1
#   define WISBLOCK_SPI_SLOTC_GPIO1_IDX  1
#   define WISBLOCK_SPI_SLOTC_GPIO1_REG  0x1
#   define _WISBLOCK_SPI_CS_GPIOS_1 <&wisblock_io WISBLOCK_IO_IO4 WISBLOCK_SPI_SLOTC_GPIO1_FLAGS>
#   undef  WISBLOCK_SPI_CS_COUNT
#   define WISBLOCK_SPI_CS_COUNT 2
#  elif WISBLOCK_SPI_CS_COUNT == 2
#   define WISBLOCK_SPI_IO4_IDX          2
#   define WISBLOCK_SPI_SLOTC_GPIO1_IDX  2
#   define WISBLOCK_SPI_SLOTC_GPIO1_REG  0x2
#   define _WISBLOCK_SPI_CS_GPIOS_2 <&wisblock_io WISBLOCK_IO_IO4 WISBLOCK_SPI_SLOTC_GPIO1_FLAGS>
#   undef  WISBLOCK_SPI_CS_COUNT
#   define WISBLOCK_SPI_CS_COUNT 3
#  elif WISBLOCK_SPI_CS_COUNT == 3
#   define WISBLOCK_SPI_IO4_IDX          3
#   define WISBLOCK_SPI_SLOTC_GPIO1_IDX  3
#   define WISBLOCK_SPI_SLOTC_GPIO1_REG  0x3
#   define _WISBLOCK_SPI_CS_GPIOS_3 <&wisblock_io WISBLOCK_IO_IO4 WISBLOCK_SPI_SLOTC_GPIO1_FLAGS>
#   undef  WISBLOCK_SPI_CS_COUNT
#   define WISBLOCK_SPI_CS_COUNT 4
#  elif WISBLOCK_SPI_CS_COUNT == 4
#   define WISBLOCK_SPI_IO4_IDX          4
#   define WISBLOCK_SPI_SLOTC_GPIO1_IDX  4
#   define WISBLOCK_SPI_SLOTC_GPIO1_REG  0x4
#   define _WISBLOCK_SPI_CS_GPIOS_4 <&wisblock_io WISBLOCK_IO_IO4 WISBLOCK_SPI_SLOTC_GPIO1_FLAGS>
#   undef  WISBLOCK_SPI_CS_COUNT
#   define WISBLOCK_SPI_CS_COUNT 5
#  elif WISBLOCK_SPI_CS_COUNT == 5
#   define WISBLOCK_SPI_IO4_IDX          5
#   define WISBLOCK_SPI_SLOTC_GPIO1_IDX  5
#   define WISBLOCK_SPI_SLOTC_GPIO1_REG  0x5
#   define _WISBLOCK_SPI_CS_GPIOS_5 <&wisblock_io WISBLOCK_IO_IO4 WISBLOCK_SPI_SLOTC_GPIO1_FLAGS>
#   undef  WISBLOCK_SPI_CS_COUNT
#   define WISBLOCK_SPI_CS_COUNT 6
#  elif WISBLOCK_SPI_CS_COUNT == 6
#   define WISBLOCK_SPI_IO4_IDX          6
#   define WISBLOCK_SPI_SLOTC_GPIO1_IDX  6
#   define WISBLOCK_SPI_SLOTC_GPIO1_REG  0x6
#   define _WISBLOCK_SPI_CS_GPIOS_6 <&wisblock_io WISBLOCK_IO_IO4 WISBLOCK_SPI_SLOTC_GPIO1_FLAGS>
#   undef  WISBLOCK_SPI_CS_COUNT
#   define WISBLOCK_SPI_CS_COUNT 7
#  endif
# endif /* !WISBLOCK_SPI_IO4_IDX */
#endif /* SLOTC_GPIO1 */

/* Slot C GPIO2 -> IO3 */
#if defined(WISBLOCK_SPI_USE_SLOTC_GPIO2) && !defined(WISBLOCK_SPI_SLOTC_GPIO2_IDX)
# ifndef WISBLOCK_SPI_IO3_IDX
#  if   WISBLOCK_SPI_CS_COUNT == 0
#   define WISBLOCK_SPI_IO3_IDX          0
#   define WISBLOCK_SPI_SLOTC_GPIO2_IDX  0
#   define WISBLOCK_SPI_SLOTC_GPIO2_REG  0x0
#   define _WISBLOCK_SPI_CS_GPIOS_0 <&wisblock_io WISBLOCK_IO_IO3 WISBLOCK_SPI_SLOTC_GPIO2_FLAGS>
#   undef  WISBLOCK_SPI_CS_COUNT
#   define WISBLOCK_SPI_CS_COUNT 1
#  elif WISBLOCK_SPI_CS_COUNT == 1
#   define WISBLOCK_SPI_IO3_IDX          1
#   define WISBLOCK_SPI_SLOTC_GPIO2_IDX  1
#   define WISBLOCK_SPI_SLOTC_GPIO2_REG  0x1
#   define _WISBLOCK_SPI_CS_GPIOS_1 <&wisblock_io WISBLOCK_IO_IO3 WISBLOCK_SPI_SLOTC_GPIO2_FLAGS>
#   undef  WISBLOCK_SPI_CS_COUNT
#   define WISBLOCK_SPI_CS_COUNT 2
#  elif WISBLOCK_SPI_CS_COUNT == 2
#   define WISBLOCK_SPI_IO3_IDX          2
#   define WISBLOCK_SPI_SLOTC_GPIO2_IDX  2
#   define WISBLOCK_SPI_SLOTC_GPIO2_REG  0x2
#   define _WISBLOCK_SPI_CS_GPIOS_2 <&wisblock_io WISBLOCK_IO_IO3 WISBLOCK_SPI_SLOTC_GPIO2_FLAGS>
#   undef  WISBLOCK_SPI_CS_COUNT
#   define WISBLOCK_SPI_CS_COUNT 3
#  elif WISBLOCK_SPI_CS_COUNT == 3
#   define WISBLOCK_SPI_IO3_IDX          3
#   define WISBLOCK_SPI_SLOTC_GPIO2_IDX  3
#   define WISBLOCK_SPI_SLOTC_GPIO2_REG  0x3
#   define _WISBLOCK_SPI_CS_GPIOS_3 <&wisblock_io WISBLOCK_IO_IO3 WISBLOCK_SPI_SLOTC_GPIO2_FLAGS>
#   undef  WISBLOCK_SPI_CS_COUNT
#   define WISBLOCK_SPI_CS_COUNT 4
#  elif WISBLOCK_SPI_CS_COUNT == 4
#   define WISBLOCK_SPI_IO3_IDX          4
#   define WISBLOCK_SPI_SLOTC_GPIO2_IDX  4
#   define WISBLOCK_SPI_SLOTC_GPIO2_REG  0x4
#   define _WISBLOCK_SPI_CS_GPIOS_4 <&wisblock_io WISBLOCK_IO_IO3 WISBLOCK_SPI_SLOTC_GPIO2_FLAGS>
#   undef  WISBLOCK_SPI_CS_COUNT
#   define WISBLOCK_SPI_CS_COUNT 5
#  elif WISBLOCK_SPI_CS_COUNT == 5
#   define WISBLOCK_SPI_IO3_IDX          5
#   define WISBLOCK_SPI_SLOTC_GPIO2_IDX  5
#   define WISBLOCK_SPI_SLOTC_GPIO2_REG  0x5
#   define _WISBLOCK_SPI_CS_GPIOS_5 <&wisblock_io WISBLOCK_IO_IO3 WISBLOCK_SPI_SLOTC_GPIO2_FLAGS>
#   undef  WISBLOCK_SPI_CS_COUNT
#   define WISBLOCK_SPI_CS_COUNT 6
#  elif WISBLOCK_SPI_CS_COUNT == 6
#   define WISBLOCK_SPI_IO3_IDX          6
#   define WISBLOCK_SPI_SLOTC_GPIO2_IDX  6
#   define WISBLOCK_SPI_SLOTC_GPIO2_REG  0x6
#   define _WISBLOCK_SPI_CS_GPIOS_6 <&wisblock_io WISBLOCK_IO_IO3 WISBLOCK_SPI_SLOTC_GPIO2_FLAGS>
#   undef  WISBLOCK_SPI_CS_COUNT
#   define WISBLOCK_SPI_CS_COUNT 7
#  endif
# endif /* !WISBLOCK_SPI_IO3_IDX */
#endif /* SLOTC_GPIO2 */

/* Slot D GPIO1 -> IO6 */
#if defined(WISBLOCK_SPI_USE_SLOTD_GPIO1) && !defined(WISBLOCK_SPI_SLOTD_GPIO1_IDX)
# ifndef WISBLOCK_SPI_IO6_IDX
#  if   WISBLOCK_SPI_CS_COUNT == 0
#   define WISBLOCK_SPI_IO6_IDX          0
#   define WISBLOCK_SPI_SLOTD_GPIO1_IDX  0
#   define WISBLOCK_SPI_SLOTD_GPIO1_REG  0x0
#   define _WISBLOCK_SPI_CS_GPIOS_0 <&wisblock_io WISBLOCK_IO_IO6 WISBLOCK_SPI_SLOTD_GPIO1_FLAGS>
#   undef  WISBLOCK_SPI_CS_COUNT
#   define WISBLOCK_SPI_CS_COUNT 1
#  elif WISBLOCK_SPI_CS_COUNT == 1
#   define WISBLOCK_SPI_IO6_IDX          1
#   define WISBLOCK_SPI_SLOTD_GPIO1_IDX  1
#   define WISBLOCK_SPI_SLOTD_GPIO1_REG  0x1
#   define _WISBLOCK_SPI_CS_GPIOS_1 <&wisblock_io WISBLOCK_IO_IO6 WISBLOCK_SPI_SLOTD_GPIO1_FLAGS>
#   undef  WISBLOCK_SPI_CS_COUNT
#   define WISBLOCK_SPI_CS_COUNT 2
#  elif WISBLOCK_SPI_CS_COUNT == 2
#   define WISBLOCK_SPI_IO6_IDX          2
#   define WISBLOCK_SPI_SLOTD_GPIO1_IDX  2
#   define WISBLOCK_SPI_SLOTD_GPIO1_REG  0x2
#   define _WISBLOCK_SPI_CS_GPIOS_2 <&wisblock_io WISBLOCK_IO_IO6 WISBLOCK_SPI_SLOTD_GPIO1_FLAGS>
#   undef  WISBLOCK_SPI_CS_COUNT
#   define WISBLOCK_SPI_CS_COUNT 3
#  elif WISBLOCK_SPI_CS_COUNT == 3
#   define WISBLOCK_SPI_IO6_IDX          3
#   define WISBLOCK_SPI_SLOTD_GPIO1_IDX  3
#   define WISBLOCK_SPI_SLOTD_GPIO1_REG  0x3
#   define _WISBLOCK_SPI_CS_GPIOS_3 <&wisblock_io WISBLOCK_IO_IO6 WISBLOCK_SPI_SLOTD_GPIO1_FLAGS>
#   undef  WISBLOCK_SPI_CS_COUNT
#   define WISBLOCK_SPI_CS_COUNT 4
#  elif WISBLOCK_SPI_CS_COUNT == 4
#   define WISBLOCK_SPI_IO6_IDX          4
#   define WISBLOCK_SPI_SLOTD_GPIO1_IDX  4
#   define WISBLOCK_SPI_SLOTD_GPIO1_REG  0x4
#   define _WISBLOCK_SPI_CS_GPIOS_4 <&wisblock_io WISBLOCK_IO_IO6 WISBLOCK_SPI_SLOTD_GPIO1_FLAGS>
#   undef  WISBLOCK_SPI_CS_COUNT
#   define WISBLOCK_SPI_CS_COUNT 5
#  elif WISBLOCK_SPI_CS_COUNT == 5
#   define WISBLOCK_SPI_IO6_IDX          5
#   define WISBLOCK_SPI_SLOTD_GPIO1_IDX  5
#   define WISBLOCK_SPI_SLOTD_GPIO1_REG  0x5
#   define _WISBLOCK_SPI_CS_GPIOS_5 <&wisblock_io WISBLOCK_IO_IO6 WISBLOCK_SPI_SLOTD_GPIO1_FLAGS>
#   undef  WISBLOCK_SPI_CS_COUNT
#   define WISBLOCK_SPI_CS_COUNT 6
#  elif WISBLOCK_SPI_CS_COUNT == 6
#   define WISBLOCK_SPI_IO6_IDX          6
#   define WISBLOCK_SPI_SLOTD_GPIO1_IDX  6
#   define WISBLOCK_SPI_SLOTD_GPIO1_REG  0x6
#   define _WISBLOCK_SPI_CS_GPIOS_6 <&wisblock_io WISBLOCK_IO_IO6 WISBLOCK_SPI_SLOTD_GPIO1_FLAGS>
#   undef  WISBLOCK_SPI_CS_COUNT
#   define WISBLOCK_SPI_CS_COUNT 7
#  endif
# endif /* !WISBLOCK_SPI_IO6_IDX */
#endif /* SLOTD_GPIO1 */

/* Slot D GPIO2 -> IO5 */
#if defined(WISBLOCK_SPI_USE_SLOTD_GPIO2) && !defined(WISBLOCK_SPI_SLOTD_GPIO2_IDX)
# ifndef WISBLOCK_SPI_IO5_IDX
#  if   WISBLOCK_SPI_CS_COUNT == 0
#   define WISBLOCK_SPI_IO5_IDX          0
#   define WISBLOCK_SPI_SLOTD_GPIO2_IDX  0
#   define WISBLOCK_SPI_SLOTD_GPIO2_REG  0x0
#   define _WISBLOCK_SPI_CS_GPIOS_0 <&wisblock_io WISBLOCK_IO_IO5 WISBLOCK_SPI_SLOTD_GPIO2_FLAGS>
#   undef  WISBLOCK_SPI_CS_COUNT
#   define WISBLOCK_SPI_CS_COUNT 1
#  elif WISBLOCK_SPI_CS_COUNT == 1
#   define WISBLOCK_SPI_IO5_IDX          1
#   define WISBLOCK_SPI_SLOTD_GPIO2_IDX  1
#   define WISBLOCK_SPI_SLOTD_GPIO2_REG  0x1
#   define _WISBLOCK_SPI_CS_GPIOS_1 <&wisblock_io WISBLOCK_IO_IO5 WISBLOCK_SPI_SLOTD_GPIO2_FLAGS>
#   undef  WISBLOCK_SPI_CS_COUNT
#   define WISBLOCK_SPI_CS_COUNT 2
#  elif WISBLOCK_SPI_CS_COUNT == 2
#   define WISBLOCK_SPI_IO5_IDX          2
#   define WISBLOCK_SPI_SLOTD_GPIO2_IDX  2
#   define WISBLOCK_SPI_SLOTD_GPIO2_REG  0x2
#   define _WISBLOCK_SPI_CS_GPIOS_2 <&wisblock_io WISBLOCK_IO_IO5 WISBLOCK_SPI_SLOTD_GPIO2_FLAGS>
#   undef  WISBLOCK_SPI_CS_COUNT
#   define WISBLOCK_SPI_CS_COUNT 3
#  elif WISBLOCK_SPI_CS_COUNT == 3
#   define WISBLOCK_SPI_IO5_IDX          3
#   define WISBLOCK_SPI_SLOTD_GPIO2_IDX  3
#   define WISBLOCK_SPI_SLOTD_GPIO2_REG  0x3
#   define _WISBLOCK_SPI_CS_GPIOS_3 <&wisblock_io WISBLOCK_IO_IO5 WISBLOCK_SPI_SLOTD_GPIO2_FLAGS>
#   undef  WISBLOCK_SPI_CS_COUNT
#   define WISBLOCK_SPI_CS_COUNT 4
#  elif WISBLOCK_SPI_CS_COUNT == 4
#   define WISBLOCK_SPI_IO5_IDX          4
#   define WISBLOCK_SPI_SLOTD_GPIO2_IDX  4
#   define WISBLOCK_SPI_SLOTD_GPIO2_REG  0x4
#   define _WISBLOCK_SPI_CS_GPIOS_4 <&wisblock_io WISBLOCK_IO_IO5 WISBLOCK_SPI_SLOTD_GPIO2_FLAGS>
#   undef  WISBLOCK_SPI_CS_COUNT
#   define WISBLOCK_SPI_CS_COUNT 5
#  elif WISBLOCK_SPI_CS_COUNT == 5
#   define WISBLOCK_SPI_IO5_IDX          5
#   define WISBLOCK_SPI_SLOTD_GPIO2_IDX  5
#   define WISBLOCK_SPI_SLOTD_GPIO2_REG  0x5
#   define _WISBLOCK_SPI_CS_GPIOS_5 <&wisblock_io WISBLOCK_IO_IO5 WISBLOCK_SPI_SLOTD_GPIO2_FLAGS>
#   undef  WISBLOCK_SPI_CS_COUNT
#   define WISBLOCK_SPI_CS_COUNT 6
#  elif WISBLOCK_SPI_CS_COUNT == 6
#   define WISBLOCK_SPI_IO5_IDX          6
#   define WISBLOCK_SPI_SLOTD_GPIO2_IDX  6
#   define WISBLOCK_SPI_SLOTD_GPIO2_REG  0x6
#   define _WISBLOCK_SPI_CS_GPIOS_6 <&wisblock_io WISBLOCK_IO_IO5 WISBLOCK_SPI_SLOTD_GPIO2_FLAGS>
#   undef  WISBLOCK_SPI_CS_COUNT
#   define WISBLOCK_SPI_CS_COUNT 7
#  endif
# endif /* !WISBLOCK_SPI_IO5_IDX */
#endif /* SLOTD_GPIO2 */

/* Slot E GPIO1 -> IO3 */
#if defined(WISBLOCK_SPI_USE_SLOTE_GPIO1) && !defined(WISBLOCK_SPI_SLOTE_GPIO1_IDX)
# ifndef WISBLOCK_SPI_IO3_IDX
#  if   WISBLOCK_SPI_CS_COUNT == 0
#   define WISBLOCK_SPI_IO3_IDX          0
#   define WISBLOCK_SPI_SLOTE_GPIO1_IDX  0
#   define WISBLOCK_SPI_SLOTE_GPIO1_REG  0x0
#   define _WISBLOCK_SPI_CS_GPIOS_0 <&wisblock_io WISBLOCK_IO_IO3 WISBLOCK_SPI_SLOTE_GPIO1_FLAGS>
#   undef  WISBLOCK_SPI_CS_COUNT
#   define WISBLOCK_SPI_CS_COUNT 1
#  elif WISBLOCK_SPI_CS_COUNT == 1
#   define WISBLOCK_SPI_IO3_IDX          1
#   define WISBLOCK_SPI_SLOTE_GPIO1_IDX  1
#   define WISBLOCK_SPI_SLOTE_GPIO1_REG  0x1
#   define _WISBLOCK_SPI_CS_GPIOS_1 <&wisblock_io WISBLOCK_IO_IO3 WISBLOCK_SPI_SLOTE_GPIO1_FLAGS>
#   undef  WISBLOCK_SPI_CS_COUNT
#   define WISBLOCK_SPI_CS_COUNT 2
#  elif WISBLOCK_SPI_CS_COUNT == 2
#   define WISBLOCK_SPI_IO3_IDX          2
#   define WISBLOCK_SPI_SLOTE_GPIO1_IDX  2
#   define WISBLOCK_SPI_SLOTE_GPIO1_REG  0x2
#   define _WISBLOCK_SPI_CS_GPIOS_2 <&wisblock_io WISBLOCK_IO_IO3 WISBLOCK_SPI_SLOTE_GPIO1_FLAGS>
#   undef  WISBLOCK_SPI_CS_COUNT
#   define WISBLOCK_SPI_CS_COUNT 3
#  elif WISBLOCK_SPI_CS_COUNT == 3
#   define WISBLOCK_SPI_IO3_IDX          3
#   define WISBLOCK_SPI_SLOTE_GPIO1_IDX  3
#   define WISBLOCK_SPI_SLOTE_GPIO1_REG  0x3
#   define _WISBLOCK_SPI_CS_GPIOS_3 <&wisblock_io WISBLOCK_IO_IO3 WISBLOCK_SPI_SLOTE_GPIO1_FLAGS>
#   undef  WISBLOCK_SPI_CS_COUNT
#   define WISBLOCK_SPI_CS_COUNT 4
#  elif WISBLOCK_SPI_CS_COUNT == 4
#   define WISBLOCK_SPI_IO3_IDX          4
#   define WISBLOCK_SPI_SLOTE_GPIO1_IDX  4
#   define WISBLOCK_SPI_SLOTE_GPIO1_REG  0x4
#   define _WISBLOCK_SPI_CS_GPIOS_4 <&wisblock_io WISBLOCK_IO_IO3 WISBLOCK_SPI_SLOTE_GPIO1_FLAGS>
#   undef  WISBLOCK_SPI_CS_COUNT
#   define WISBLOCK_SPI_CS_COUNT 5
#  elif WISBLOCK_SPI_CS_COUNT == 5
#   define WISBLOCK_SPI_IO3_IDX          5
#   define WISBLOCK_SPI_SLOTE_GPIO1_IDX  5
#   define WISBLOCK_SPI_SLOTE_GPIO1_REG  0x5
#   define _WISBLOCK_SPI_CS_GPIOS_5 <&wisblock_io WISBLOCK_IO_IO3 WISBLOCK_SPI_SLOTE_GPIO1_FLAGS>
#   undef  WISBLOCK_SPI_CS_COUNT
#   define WISBLOCK_SPI_CS_COUNT 6
#  elif WISBLOCK_SPI_CS_COUNT == 6
#   define WISBLOCK_SPI_IO3_IDX          6
#   define WISBLOCK_SPI_SLOTE_GPIO1_IDX  6
#   define WISBLOCK_SPI_SLOTE_GPIO1_REG  0x6
#   define _WISBLOCK_SPI_CS_GPIOS_6 <&wisblock_io WISBLOCK_IO_IO3 WISBLOCK_SPI_SLOTE_GPIO1_FLAGS>
#   undef  WISBLOCK_SPI_CS_COUNT
#   define WISBLOCK_SPI_CS_COUNT 7
#  endif
# endif /* !WISBLOCK_SPI_IO3_IDX */
#endif /* SLOTE_GPIO1 */

/* Slot E GPIO2 -> IO4 */
#if defined(WISBLOCK_SPI_USE_SLOTE_GPIO2) && !defined(WISBLOCK_SPI_SLOTE_GPIO2_IDX)
# ifndef WISBLOCK_SPI_IO4_IDX
#  if   WISBLOCK_SPI_CS_COUNT == 0
#   define WISBLOCK_SPI_IO4_IDX          0
#   define WISBLOCK_SPI_SLOTE_GPIO2_IDX  0
#   define WISBLOCK_SPI_SLOTE_GPIO2_REG  0x0
#   define _WISBLOCK_SPI_CS_GPIOS_0 <&wisblock_io WISBLOCK_IO_IO4 WISBLOCK_SPI_SLOTE_GPIO2_FLAGS>
#   undef  WISBLOCK_SPI_CS_COUNT
#   define WISBLOCK_SPI_CS_COUNT 1
#  elif WISBLOCK_SPI_CS_COUNT == 1
#   define WISBLOCK_SPI_IO4_IDX          1
#   define WISBLOCK_SPI_SLOTE_GPIO2_IDX  1
#   define WISBLOCK_SPI_SLOTE_GPIO2_REG  0x1
#   define _WISBLOCK_SPI_CS_GPIOS_1 <&wisblock_io WISBLOCK_IO_IO4 WISBLOCK_SPI_SLOTE_GPIO2_FLAGS>
#   undef  WISBLOCK_SPI_CS_COUNT
#   define WISBLOCK_SPI_CS_COUNT 2
#  elif WISBLOCK_SPI_CS_COUNT == 2
#   define WISBLOCK_SPI_IO4_IDX          2
#   define WISBLOCK_SPI_SLOTE_GPIO2_IDX  2
#   define WISBLOCK_SPI_SLOTE_GPIO2_REG  0x2
#   define _WISBLOCK_SPI_CS_GPIOS_2 <&wisblock_io WISBLOCK_IO_IO4 WISBLOCK_SPI_SLOTE_GPIO2_FLAGS>
#   undef  WISBLOCK_SPI_CS_COUNT
#   define WISBLOCK_SPI_CS_COUNT 3
#  elif WISBLOCK_SPI_CS_COUNT == 3
#   define WISBLOCK_SPI_IO4_IDX          3
#   define WISBLOCK_SPI_SLOTE_GPIO2_IDX  3
#   define WISBLOCK_SPI_SLOTE_GPIO2_REG  0x3
#   define _WISBLOCK_SPI_CS_GPIOS_3 <&wisblock_io WISBLOCK_IO_IO4 WISBLOCK_SPI_SLOTE_GPIO2_FLAGS>
#   undef  WISBLOCK_SPI_CS_COUNT
#   define WISBLOCK_SPI_CS_COUNT 4
#  elif WISBLOCK_SPI_CS_COUNT == 4
#   define WISBLOCK_SPI_IO4_IDX          4
#   define WISBLOCK_SPI_SLOTE_GPIO2_IDX  4
#   define WISBLOCK_SPI_SLOTE_GPIO2_REG  0x4
#   define _WISBLOCK_SPI_CS_GPIOS_4 <&wisblock_io WISBLOCK_IO_IO4 WISBLOCK_SPI_SLOTE_GPIO2_FLAGS>
#   undef  WISBLOCK_SPI_CS_COUNT
#   define WISBLOCK_SPI_CS_COUNT 5
#  elif WISBLOCK_SPI_CS_COUNT == 5
#   define WISBLOCK_SPI_IO4_IDX          5
#   define WISBLOCK_SPI_SLOTE_GPIO2_IDX  5
#   define WISBLOCK_SPI_SLOTE_GPIO2_REG  0x5
#   define _WISBLOCK_SPI_CS_GPIOS_5 <&wisblock_io WISBLOCK_IO_IO4 WISBLOCK_SPI_SLOTE_GPIO2_FLAGS>
#   undef  WISBLOCK_SPI_CS_COUNT
#   define WISBLOCK_SPI_CS_COUNT 6
#  elif WISBLOCK_SPI_CS_COUNT == 6
#   define WISBLOCK_SPI_IO4_IDX          6
#   define WISBLOCK_SPI_SLOTE_GPIO2_IDX  6
#   define WISBLOCK_SPI_SLOTE_GPIO2_REG  0x6
#   define _WISBLOCK_SPI_CS_GPIOS_6 <&wisblock_io WISBLOCK_IO_IO4 WISBLOCK_SPI_SLOTE_GPIO2_FLAGS>
#   undef  WISBLOCK_SPI_CS_COUNT
#   define WISBLOCK_SPI_CS_COUNT 7
#  endif
# endif /* !WISBLOCK_SPI_IO4_IDX */
#endif /* SLOTE_GPIO2 */

/* Slot F GPIO1 -> IO5 */
#if defined(WISBLOCK_SPI_USE_SLOTF_GPIO1) && !defined(WISBLOCK_SPI_SLOTF_GPIO1_IDX)
# ifndef WISBLOCK_SPI_IO5_IDX
#  if   WISBLOCK_SPI_CS_COUNT == 0
#   define WISBLOCK_SPI_IO5_IDX          0
#   define WISBLOCK_SPI_SLOTF_GPIO1_IDX  0
#   define WISBLOCK_SPI_SLOTF_GPIO1_REG  0x0
#   define _WISBLOCK_SPI_CS_GPIOS_0 <&wisblock_io WISBLOCK_IO_IO5 WISBLOCK_SPI_SLOTF_GPIO1_FLAGS>
#   undef  WISBLOCK_SPI_CS_COUNT
#   define WISBLOCK_SPI_CS_COUNT 1
#  elif WISBLOCK_SPI_CS_COUNT == 1
#   define WISBLOCK_SPI_IO5_IDX          1
#   define WISBLOCK_SPI_SLOTF_GPIO1_IDX  1
#   define WISBLOCK_SPI_SLOTF_GPIO1_REG  0x1
#   define _WISBLOCK_SPI_CS_GPIOS_1 <&wisblock_io WISBLOCK_IO_IO5 WISBLOCK_SPI_SLOTF_GPIO1_FLAGS>
#   undef  WISBLOCK_SPI_CS_COUNT
#   define WISBLOCK_SPI_CS_COUNT 2
#  elif WISBLOCK_SPI_CS_COUNT == 2
#   define WISBLOCK_SPI_IO5_IDX          2
#   define WISBLOCK_SPI_SLOTF_GPIO1_IDX  2
#   define WISBLOCK_SPI_SLOTF_GPIO1_REG  0x2
#   define _WISBLOCK_SPI_CS_GPIOS_2 <&wisblock_io WISBLOCK_IO_IO5 WISBLOCK_SPI_SLOTF_GPIO1_FLAGS>
#   undef  WISBLOCK_SPI_CS_COUNT
#   define WISBLOCK_SPI_CS_COUNT 3
#  elif WISBLOCK_SPI_CS_COUNT == 3
#   define WISBLOCK_SPI_IO5_IDX          3
#   define WISBLOCK_SPI_SLOTF_GPIO1_IDX  3
#   define WISBLOCK_SPI_SLOTF_GPIO1_REG  0x3
#   define _WISBLOCK_SPI_CS_GPIOS_3 <&wisblock_io WISBLOCK_IO_IO5 WISBLOCK_SPI_SLOTF_GPIO1_FLAGS>
#   undef  WISBLOCK_SPI_CS_COUNT
#   define WISBLOCK_SPI_CS_COUNT 4
#  elif WISBLOCK_SPI_CS_COUNT == 4
#   define WISBLOCK_SPI_IO5_IDX          4
#   define WISBLOCK_SPI_SLOTF_GPIO1_IDX  4
#   define WISBLOCK_SPI_SLOTF_GPIO1_REG  0x4
#   define _WISBLOCK_SPI_CS_GPIOS_4 <&wisblock_io WISBLOCK_IO_IO5 WISBLOCK_SPI_SLOTF_GPIO1_FLAGS>
#   undef  WISBLOCK_SPI_CS_COUNT
#   define WISBLOCK_SPI_CS_COUNT 5
#  elif WISBLOCK_SPI_CS_COUNT == 5
#   define WISBLOCK_SPI_IO5_IDX          5
#   define WISBLOCK_SPI_SLOTF_GPIO1_IDX  5
#   define WISBLOCK_SPI_SLOTF_GPIO1_REG  0x5
#   define _WISBLOCK_SPI_CS_GPIOS_5 <&wisblock_io WISBLOCK_IO_IO5 WISBLOCK_SPI_SLOTF_GPIO1_FLAGS>
#   undef  WISBLOCK_SPI_CS_COUNT
#   define WISBLOCK_SPI_CS_COUNT 6
#  elif WISBLOCK_SPI_CS_COUNT == 6
#   define WISBLOCK_SPI_IO5_IDX          6
#   define WISBLOCK_SPI_SLOTF_GPIO1_IDX  6
#   define WISBLOCK_SPI_SLOTF_GPIO1_REG  0x6
#   define _WISBLOCK_SPI_CS_GPIOS_6 <&wisblock_io WISBLOCK_IO_IO5 WISBLOCK_SPI_SLOTF_GPIO1_FLAGS>
#   undef  WISBLOCK_SPI_CS_COUNT
#   define WISBLOCK_SPI_CS_COUNT 7
#  endif
# endif /* !WISBLOCK_SPI_IO5_IDX */
#endif /* SLOTF_GPIO1 */

/* Slot F GPIO2 -> IO6 */
#if defined(WISBLOCK_SPI_USE_SLOTF_GPIO2) && !defined(WISBLOCK_SPI_SLOTF_GPIO2_IDX)
# ifndef WISBLOCK_SPI_IO6_IDX
#  if   WISBLOCK_SPI_CS_COUNT == 0
#   define WISBLOCK_SPI_IO6_IDX          0
#   define WISBLOCK_SPI_SLOTF_GPIO2_IDX  0
#   define WISBLOCK_SPI_SLOTF_GPIO2_REG  0x0
#   define _WISBLOCK_SPI_CS_GPIOS_0 <&wisblock_io WISBLOCK_IO_IO6 WISBLOCK_SPI_SLOTF_GPIO2_FLAGS>
#   undef  WISBLOCK_SPI_CS_COUNT
#   define WISBLOCK_SPI_CS_COUNT 1
#  elif WISBLOCK_SPI_CS_COUNT == 1
#   define WISBLOCK_SPI_IO6_IDX          1
#   define WISBLOCK_SPI_SLOTF_GPIO2_IDX  1
#   define WISBLOCK_SPI_SLOTF_GPIO2_REG  0x1
#   define _WISBLOCK_SPI_CS_GPIOS_1 <&wisblock_io WISBLOCK_IO_IO6 WISBLOCK_SPI_SLOTF_GPIO2_FLAGS>
#   undef  WISBLOCK_SPI_CS_COUNT
#   define WISBLOCK_SPI_CS_COUNT 2
#  elif WISBLOCK_SPI_CS_COUNT == 2
#   define WISBLOCK_SPI_IO6_IDX          2
#   define WISBLOCK_SPI_SLOTF_GPIO2_IDX  2
#   define WISBLOCK_SPI_SLOTF_GPIO2_REG  0x2
#   define _WISBLOCK_SPI_CS_GPIOS_2 <&wisblock_io WISBLOCK_IO_IO6 WISBLOCK_SPI_SLOTF_GPIO2_FLAGS>
#   undef  WISBLOCK_SPI_CS_COUNT
#   define WISBLOCK_SPI_CS_COUNT 3
#  elif WISBLOCK_SPI_CS_COUNT == 3
#   define WISBLOCK_SPI_IO6_IDX          3
#   define WISBLOCK_SPI_SLOTF_GPIO2_IDX  3
#   define WISBLOCK_SPI_SLOTF_GPIO2_REG  0x3
#   define _WISBLOCK_SPI_CS_GPIOS_3 <&wisblock_io WISBLOCK_IO_IO6 WISBLOCK_SPI_SLOTF_GPIO2_FLAGS>
#   undef  WISBLOCK_SPI_CS_COUNT
#   define WISBLOCK_SPI_CS_COUNT 4
#  elif WISBLOCK_SPI_CS_COUNT == 4
#   define WISBLOCK_SPI_IO6_IDX          4
#   define WISBLOCK_SPI_SLOTF_GPIO2_IDX  4
#   define WISBLOCK_SPI_SLOTF_GPIO2_REG  0x4
#   define _WISBLOCK_SPI_CS_GPIOS_4 <&wisblock_io WISBLOCK_IO_IO6 WISBLOCK_SPI_SLOTF_GPIO2_FLAGS>
#   undef  WISBLOCK_SPI_CS_COUNT
#   define WISBLOCK_SPI_CS_COUNT 5
#  elif WISBLOCK_SPI_CS_COUNT == 5
#   define WISBLOCK_SPI_IO6_IDX          5
#   define WISBLOCK_SPI_SLOTF_GPIO2_IDX  5
#   define WISBLOCK_SPI_SLOTF_GPIO2_REG  0x5
#   define _WISBLOCK_SPI_CS_GPIOS_5 <&wisblock_io WISBLOCK_IO_IO6 WISBLOCK_SPI_SLOTF_GPIO2_FLAGS>
#   undef  WISBLOCK_SPI_CS_COUNT
#   define WISBLOCK_SPI_CS_COUNT 6
#  elif WISBLOCK_SPI_CS_COUNT == 6
#   define WISBLOCK_SPI_IO6_IDX          6
#   define WISBLOCK_SPI_SLOTF_GPIO2_IDX  6
#   define WISBLOCK_SPI_SLOTF_GPIO2_REG  0x6
#   define _WISBLOCK_SPI_CS_GPIOS_6 <&wisblock_io WISBLOCK_IO_IO6 WISBLOCK_SPI_SLOTF_GPIO2_FLAGS>
#   undef  WISBLOCK_SPI_CS_COUNT
#   define WISBLOCK_SPI_CS_COUNT 7
#  endif
# endif /* !WISBLOCK_SPI_IO6_IDX */
#endif /* SLOTF_GPIO2 */

/*
 * Rebuild WISBLOCK_SPI_CS_GPIOS from all occupied slots.
 *
 * Runs on every include so the macro always reflects the accumulated state
 * at that textual position in the concatenated overlay file. DTS
 * last-writer-wins means the final shield's cs-gpios assignment contains
 * the complete array for all shields combined.
 */
#undef WISBLOCK_SPI_CS_GPIOS
#if   WISBLOCK_SPI_CS_COUNT == 1
# define WISBLOCK_SPI_CS_GPIOS \
	_WISBLOCK_SPI_CS_GPIOS_0
#elif WISBLOCK_SPI_CS_COUNT == 2
# define WISBLOCK_SPI_CS_GPIOS \
	_WISBLOCK_SPI_CS_GPIOS_0, \
	_WISBLOCK_SPI_CS_GPIOS_1
#elif WISBLOCK_SPI_CS_COUNT == 3
# define WISBLOCK_SPI_CS_GPIOS \
	_WISBLOCK_SPI_CS_GPIOS_0, \
	_WISBLOCK_SPI_CS_GPIOS_1, \
	_WISBLOCK_SPI_CS_GPIOS_2
#elif WISBLOCK_SPI_CS_COUNT == 4
# define WISBLOCK_SPI_CS_GPIOS \
	_WISBLOCK_SPI_CS_GPIOS_0, \
	_WISBLOCK_SPI_CS_GPIOS_1, \
	_WISBLOCK_SPI_CS_GPIOS_2, \
	_WISBLOCK_SPI_CS_GPIOS_3
#elif WISBLOCK_SPI_CS_COUNT == 5
# define WISBLOCK_SPI_CS_GPIOS \
	_WISBLOCK_SPI_CS_GPIOS_0, \
	_WISBLOCK_SPI_CS_GPIOS_1, \
	_WISBLOCK_SPI_CS_GPIOS_2, \
	_WISBLOCK_SPI_CS_GPIOS_3, \
	_WISBLOCK_SPI_CS_GPIOS_4
#elif WISBLOCK_SPI_CS_COUNT == 6
# define WISBLOCK_SPI_CS_GPIOS \
	_WISBLOCK_SPI_CS_GPIOS_0, \
	_WISBLOCK_SPI_CS_GPIOS_1, \
	_WISBLOCK_SPI_CS_GPIOS_2, \
	_WISBLOCK_SPI_CS_GPIOS_3, \
	_WISBLOCK_SPI_CS_GPIOS_4, \
	_WISBLOCK_SPI_CS_GPIOS_5
#elif WISBLOCK_SPI_CS_COUNT == 7
# define WISBLOCK_SPI_CS_GPIOS \
	_WISBLOCK_SPI_CS_GPIOS_0, \
	_WISBLOCK_SPI_CS_GPIOS_1, \
	_WISBLOCK_SPI_CS_GPIOS_2, \
	_WISBLOCK_SPI_CS_GPIOS_3, \
	_WISBLOCK_SPI_CS_GPIOS_4, \
	_WISBLOCK_SPI_CS_GPIOS_5, \
	_WISBLOCK_SPI_CS_GPIOS_6
#endif /* WISBLOCK_SPI_CS_COUNT */