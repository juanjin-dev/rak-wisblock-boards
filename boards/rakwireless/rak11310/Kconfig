## boards/rakwireless/rak11310/Kconfig
```kconfig
# SPDX-License-Identifier: Apache-2.0
# Copyright (c) 2026 RAKwireless Technology Co., Ltd.

config BOARD_RAK11310
	select RP2_FLASH_W25Q080
```

## boards/rakwireless/rak11310/board.yml
```yaml
# SPDX-License-Identifier: Apache-2.0
# Copyright (c) 2026 RAKwireless Technology Co., Ltd.

board:
  name: rak11310
  full_name: RAK11310 WisBlock LoRaWAN Module
  vendor: rakwireless
  socs:
  - name: rp2040
```

## boards/rakwireless/rak11722/Kconfig.defconfig
```kconfig
# SPDX-License-Identifier: Apache-2.0
# Copyright (c) 2026 RAKwireless Technology Co., Ltd.

if BOARD_RAK11722

config SYS_CLOCK_HW_CYCLES_PER_SEC
	default 32768 if AMBIQ_STIMER_TIMER

endif # BOARD_RAK11722
```

## boards/rakwireless/rak11722/Kconfig.rak11722
```kconfig
# SPDX-License-Identifier: Apache-2.0
# Copyright (c) 2026 Shenzhen RAKwireless Technology Co., Ltd.

config BOARD_RAK11722
	select SOC_APOLLO3_BLUE
if BOARD_RAK11722

config WISBLOCK_CORE_BOARD_VENDOR
	string
	default "RAKwireless"

config WISBLOCK_CORE_BOARD_NAME
	string
	default "RAK11722 WisBlock LPWAN Module"

endif # BOARD_RAK11722
```

## boards/rakwireless/rak19026/Kconfig.defconfig
```kconfig
# SPDX-License-Identifier: Apache-2.0

if BOARD_RAK19026

config LED
	default y if !MCUBOOT

config PWM
	default y if !MCUBOOT

config ADC
	default y if !MCUBOOT

config SENSOR
	default y if !MCUBOOT

config FUEL_GAUGE
	default y if !MCUBOOT

config VOLTAGE_DIVIDER
	default y if !MCUBOOT

config FUEL_GAUGE_COMPOSITE
	default y if !MCUBOOT

if !MCUBOOT

config UDC_NRF_THREAD_STACK_SIZE
	default 2048

config USBD_THREAD_STACK_SIZE
	default 2048

source "$(ZEPHYR_BASE)/boards/common/usb/Kconfig.cdc_acm_serial.defconfig"

config CDC_ACM_SERIAL_PID
	default 0x0004

config CDC_ACM_SERIAL_MANUFACTURER_STRING
	default "RAKwireless"

config CDC_ACM_SERIAL_PRODUCT_STRING
	default "RAK19026 WisMesh Base Board"

endif # !MCUBOOT

endif # BOARD_RAK19026
```

## boards/rakwireless/rak19026/board.yml
```yaml
# SPDX-License-Identifier: Apache-2.0
# Copyright (c) 2026 Shenzhen RAKwireless Technology Co., Ltd.

board:
  name: rak19026
  full_name: RAK19026 Meshtastic WisMesh Base Board
  vendor: rakwireless
  socs:
  - name: nrf52840
```

## boards/rakwireless/rak19026/rak19026_defconfig
```kconfig
# SPDX-License-Identifier: Apache-2.0

# Enable MPU
CONFIG_ARM_MPU=y

# Enable hardware stack protection
CONFIG_HW_STACK_PROTECTION=y

# Enable RTT
CONFIG_USE_SEGGER_RTT=y

# enable GPIO
CONFIG_GPIO=y

# enable uart driver
CONFIG_SERIAL=y

# enable GNSS
CONFIG_GNSS=y
CONFIG_GNSS_SATELLITES=y
CONFIG_UART_INTERRUPT_DRIVEN=y

# enable console
CONFIG_CONSOLE=y
CONFIG_UART_CONSOLE=y
CONFIG_STDOUT_CONSOLE=y
CONFIG_UART_LINE_CTRL=y

CONFIG_USB_DEVICE_STACK_NEXT=y
CONFIG_CDC_ACM_SERIAL_INITIALIZE_AT_BOOT=y
CONFIG_CDC_ACM_SERIAL_PID=0x0004
CONFIG_CDC_ACM_SERIAL_MANUFACTURER_STRING="RAKwireless"
CONFIG_CDC_ACM_SERIAL_PRODUCT_STRING="RAK19026 WisMesh Base Board"
```

## boards/rakwireless/rak3312/Kconfig
```kconfig
# SPDX-License-Identifier: Apache-2.0
# Copyright (c) 2026 Shenzhen RAKwireless Technology Co., Ltd.

config HEAP_MEM_POOL_ADD_SIZE_BOARD
	int
	default 4096 if BOARD_RAK3312_ESP32S3_PROCPU
	default 256 if BOARD_RAK3312_ESP32S3_APPCPU
```

## boards/rakwireless/rak3312/board.yml
```yaml
# SPDX-License-Identifier: Apache-2.0
# Copyright (c) 2026 RAKwireless Technology Limited

board:
  name: rak3312
  full_name: RAK3312 WisDuo LPWAN+BLE+Wi-Fi Module
  vendor: rakwireless
  socs:
  - name: esp32s3
```

## boards/rakwireless/rak3312/rak3312_appcpu_defconfig
```kconfig
# SPDX-License-Identifier: Apache-2.0
# Copyright (c) 2026 Shenzhen RAKwireless Technology Co., Ltd.

CONFIG_CLOCK_CONTROL=y
```

## boards/rakwireless/rak3312/rak3312_procpu_defconfig
```kconfig
# SPDX-License-Identifier: Apache-2.0
# Copyright (c) 2026 RAKwireless Technology Limited

CONFIG_CLOCK_CONTROL=y
CONFIG_ESP_SPIRAM=y
CONFIG_SPIRAM_MODE_OCT=y
```

## boards/rakwireless/rak3372/Kconfig.rak3372
```kconfig
# SPDX-License-Identifier: Apache-2.0
# Copyright (c) 2026 Shenzhen RAKwireless Technology Co., Ltd.

config BOARD_RAK3372
	select SOC_STM32WLE5XX
if BOARD_RAK3372

config WISBLOCK_CORE_BOARD_VENDOR
	string
	default "RAKwireless"

config WISBLOCK_CORE_BOARD_NAME
	string
	default "RAK3372 WisBlock LPWAN Module"

endif # BOARD_RAK3372
```

## boards/rakwireless/rak3372/Kconfig.sysbuild
```kconfig
# SPDX-License-Identifier: Apache-2.0
# Copyright (c) 2026 Shenzhen RAKwireless Technology Co., Ltd.

choice MCUBOOT_MODE
	default MCUBOOT_MODE_OVERWRITE_ONLY
endchoice
```

## boards/rakwireless/rak3372/board.yml
```yaml
board:
  name: rak3372
  full_name: RAKwireless RAK3372 WisBlock LPWAN Module
  vendor: rakwireless
  socs:
  - name: stm32wle5xx
```

## boards/rakwireless/rak3372/rak3372_defconfig
```kconfig
# SPDX-License-Identifier: Apache-2.0
# Copyright (c) 2026 Shenzhen RAKwireless Technology Co., Ltd.

# Enable Clocks
CONFIG_CLOCK_CONTROL=y

# Enable MPU
CONFIG_ARM_MPU=y

# Enable HW stack protection
CONFIG_HW_STACK_PROTECTION=y
```

## boards/rakwireless/rak3401/Kconfig.rak3401
```kconfig
# SPDX-License-Identifier: Apache-2.0
# Copyright (c) 2026 Shenzhen RAKwireless Technology Co., Ltd.


config BOARD_RAK3401
	select SOC_NRF52840_QIAA
```

## boards/rakwireless/rak3401/board.yml
```yaml
# SPDX-License-Identifier: Apache-2.0
# Copyright (c) 2026 Shenzhen RAKwireless Technology Co., Ltd.

board:
  name: rak3401
  full_name: RAK3401 WisBlock BLE Module
  vendor: rakwireless
  socs:
  - name: nrf52840
```

## boards/rakwireless/rak4631re/Kconfig.rak4631re
```kconfig
config BOARD_RAK4631RE
	select SOC_NRF52840_QIAA

if BOARD_RAK4631RE

config WISBLOCK_CORE_BOARD_VENDOR
	string
	default "RAKwireless"

config WISBLOCK_CORE_BOARD_NAME
	string
	default "RAK4631 WisBlock LoRaWAN Module"

endif # BOARD_RAK4631RE
```

## boards/rakwireless/rak4631re/board.yml
```yaml
# SPDX-License-Identifier: Apache-2.0
# Copyright (c) 2026 RAKwireless Technology Limited

board:
  name: rak4631re
  full_name: RAK4631 WisBlock LoRaWAN Module
  vendor: rakwireless
  socs:
  - name: nrf52840
```

## boards/shields/rakwireless_rak19001/Kconfig.defconfig
```kconfig
# SPDX-License-Identifier: Apache-2.0
# Copyright (c) 2026 Shenzhen RAKwireless Technology Co., Ltd.

if SHIELD_RAKWIRELESS_RAK19001

config LED
	default y if !MCUBOOT

config PWM
	default y if !MCUBOOT

config ADC
	default y if !MCUBOOT

config SENSOR
	default y if !MCUBOOT

config FUEL_GAUGE
	default y if !MCUBOOT

config VOLTAGE_DIVIDER
	default y if !MCUBOOT

config FUEL_GAUGE_COMPOSITE
	default y if !MCUBOOT

WISBLOCK_HAS_CDC_ACM_CONSOLE := \
	$(dt_node_has_compat,$(dt_nodelabel_path,wisblock_console),$(DT_COMPAT_ZEPHYR_CDC_ACM_UART))

if $(WISBLOCK_HAS_CDC_ACM_CONSOLE) && !MCUBOOT

if UDC_NRF

config UDC_NRF_THREAD_STACK_SIZE
	default 2048

config USBD_THREAD_STACK_SIZE
	default 2048

endif # UDC_NRF

source "$(ZEPHYR_BASE)/boards/common/usb/Kconfig.cdc_acm_serial.defconfig"

config CDC_ACM_SERIAL_PID
	default 0x0004 if !MCUBOOT

config CDC_ACM_SERIAL_MANUFACTURER_STRING
	default WISBLOCK_CORE_BOARD_VENDOR if !MCUBOOT

config CDC_ACM_SERIAL_PRODUCT_STRING
	default WISBLOCK_CORE_BOARD_NAME if !MCUBOOT

endif # WISBLOCK_HAS_CDC_ACM_CONSOLE

if !$(WISBLOCK_HAS_CDC_ACM_CONSOLE)

config SERIAL
	default y

config CONSOLE
	default y

config UART_CONSOLE
	default CONSOLE

endif # !WISBLOCK_HAS_CDC_ACM_CONSOLE

if $(dt_nodelabel_exists,wisblock_sw1)

config INPUT
	default y if !MCUBOOT

endif # $(dt_nodelabel_exists,wisblock_sw1)

endif # SHIELD_RAKWIRELESS_RAK19001
```

## boards/shields/rakwireless_rak19001/Kconfig.shield
```kconfig
# SPDX-License-Identifier: Apache-2.0
# Copyright (c) 2026 Shenzhen RAKwireless Technology Co., Ltd.

config SHIELD_RAKWIRELESS_RAK19001
	def_bool $(shields_list_contains,rakwireless_rak19001) || \
	         $(shields_list_contains,rakwireless_rak19001_sw1)

config SHIELD_RAKWIRELESS_RAK19001_SW1
	def_bool $(shields_list_contains,rakwireless_rak19001_sw1)
	select SHIELD_RAKWIRELESS_RAK19001
```
