/*
 * SPDX-License-Identifier: Apache-2.0
 * Copyright (c) 2026 Shenzhen RAKwireless Technology Co., Ltd.
 */

#include <wisblock/wisblock_slota.dtsi>
#include <wisblock/wisblock_slotb.dtsi>
#include <wisblock/wisblock_slotc.dtsi>
#include <wisblock/wisblock_slotd.dtsi>
#include <wisblock/wisblock_slote.dtsi>
#include <wisblock/wisblock_slotf.dtsi>
