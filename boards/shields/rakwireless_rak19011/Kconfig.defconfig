## boards/shields/rakwireless_rak19011/Kconfig.defconfig
```kconfig
# SPDX-License-Identifier: Apache-2.0
# Copyright (c) 2026 RAKwireless Technology Limited

if SHIELD_RAKWIRELESS_RAK19011

if $(dt_nodelabel_exists,wisblock_sw1)

config INPUT
	default y if !MCUBOOT

endif # $(dt_nodelabel_exists,wisblock_sw1)

endif # SHIELD_RAKWIRELESS_RAK19011
```

## boards/shields/rakwireless_rak19011/Kconfig.shield
```kconfig
# SPDX-License-Identifier: Apache-2.0
# Copyright (c) 2026 Shenzhen RAKwireless Technology Co., Ltd.

config SHIELD_RAKWIRELESS_RAK19011
	def_bool $(shields_list_contains,rakwireless_rak19011) || \
	         $(shields_list_contains,rakwireless_rak19011_sw1)

config SHIELD_RAKWIRELESS_RAK19011_SW1
	def_bool $(shields_list_contains,rakwireless_rak19011_sw1)
	select SHIELD_RAKWIRELESS_RAK19011
```

## boards/shields/rakwireless_rak19016/Kconfig.defconfig
```kconfig
# SPDX-License-Identifier: Apache-2.0
# Copyright (c) 2026 Shenzhen RAKwireless Technology Co., Ltd.

if SHIELD_RAKWIRELESS_RAK19016

config LED
	default y if !MCUBOOT

config PWM
	default y if !MCUBOOT

config ADC
	default y if !MCUBOOT

config SENSOR
	default y if !MCUBOOT

config FUEL_GAUGE
	default y if !MCUBOOT

config VOLTAGE_DIVIDER
	default y if !MCUBOOT

config FUEL_GAUGE_COMPOSITE
	default y if !MCUBOOT

endif # SHIELD_RAKWIRELESS_RAK19016
```

## boards/shields/rakwireless_rak19017/Kconfig.defconfig
```kconfig
# SPDX-License-Identifier: Apache-2.0
# Copyright (c) 2026 RAKwireless Technology Limited

if SHIELD_RAKWIRELESS_RAK19017

config LED
	default y if !MCUBOOT

config PWM
	default y if !MCUBOOT

endif # SHIELD_RAKWIRELESS_RAK19017
```

## boards/shields/test_spi_shield/Kconfig.shield
```kconfig
# SPDX-License-Identifier: Apache-2.0
# Copyright (c) 2026 Shenzhen RAKwireless Technology Co., Ltd.

config SHIELD_TEST_SPI_IO1
	def_bool $(shields_list_contains,test_spi_io1)

config SHIELD_TEST_SPI_IO2
	def_bool $(shields_list_contains,test_spi_io2)

config SHIELD_TEST_SPI_IO3
	def_bool $(shields_list_contains,test_spi_io3)

config SHIELD_TEST_SPI_IO4
	def_bool $(shields_list_contains,test_spi_io4)

config SHIELD_TEST_SPI_IO5
	def_bool $(shields_list_contains,test_spi_io5)

config SHIELD_TEST_SPI_IO6
	def_bool $(shields_list_contains,test_spi_io6)

config SHIELD_TEST_SPI_SPI_CS
	def_bool $(shields_list_contains,test_spi_spi_cs)

config SHIELD_TEST_SPI_SLOTA_1
	def_bool $(shields_list_contains,test_spi_slota_1)

config SHIELD_TEST_SPI_SLOTA_2
	def_bool $(shields_list_contains,test_spi_slota_2)

config SHIELD_TEST_SPI_SLOTB_1
	def_bool $(shields_list_contains,test_spi_slotb_1)

config SHIELD_TEST_SPI_SLOTB_2
	def_bool $(shields_list_contains,test_spi_slotb_2)

config SHIELD_TEST_SPI_SLOTC_1
	def_bool $(shields_list_contains,test_spi_slotc_1)

config SHIELD_TEST_SPI_SLOTC_2
	def_bool $(shields_list_contains,test_spi_slotc_2)

config SHIELD_TEST_SPI_SLOTD_1
	def_bool $(shields_list_contains,test_spi_slotd_1)

config SHIELD_TEST_SPI_SLOTD_2
	def_bool $(shields_list_contains,test_spi_slotd_2)

config SHIELD_TEST_SPI_SLOTE_1
	def_bool $(shields_list_contains,test_spi_slote_1)

config SHIELD_TEST_SPI_SLOTE_2
	def_bool $(shields_list_contains,test_spi_slote_2)

config SHIELD_TEST_SPI_SLOTF_1
	def_bool $(shields_list_contains,test_spi_slotf_1)

config SHIELD_TEST_SPI_SLOTF_2
	def_bool $(shields_list_contains,test_spi_slotf_2)
```

## dts/bindings/adc/wisblock-adc.yaml
```yaml
# Copyright (c) 2026 RAKwireless Technology Limited
# SPDX-License-Identifier: Apache-2.0

description: |
  ADC channels exposed on the WisBlock IO connector.

  The WisBlock IO connector exposes two analog input pins (AIN0, AIN1)
  and a third analog-capable pin on IO4. This binding provides a nexus
  mapping where parent pins 0 through 2 correspond to AIN0, AIN1, and
  IO4 respectively, as defined by the WISBLOCK_ADC_* constants in
  <zephyr/dt-bindings/adc/wisblock-adc.h>.

  Example usage in a WisBlock Core board file:

    wisblock_adc: wisblock-adc {
      compatible = "wisblock-adc";
      io-channel-map = <0 &adc 0>, <1 &adc 1>, <2 &adc 4>;
      #io-channel-cells = <1>;
    };

compatible: "wisblock-adc"

include: base.yaml

properties:
  io-channel-map:
    type: compound
    required: true
    description: |
      Nexus mapping from WisBlock ADC pin indices to SoC ADC channels.
      Each entry is a tuple of (wisblock-pin, adc-phandle, adc-channel).

  io-channel-map-mask:
    type: array
    description: Mask applied to the child specifier before nexus lookup.

  io-channel-map-pass-thru:
    type: array
    description: Bits passed through unchanged from child to parent specifier.

  "#io-channel-cells":
    type: int
    required: true
    description: Number of cells in an ADC specifier. Must be 1.
```

## dts/bindings/gpio/wisblock-io-connector.yaml
```yaml
# Copyright (c) 2026 Shenzhen RAKwireless Technology Co., Ltd.
# SPDX-License-Identifier: Apache-2.0

description: |
  GPIO pins exposed on the WisBlock IO connector.

  The WisBlock IO connector is a 40-pin board-to-board connector that
  carries power, UART, SPI, I2C, analog inputs, and general-purpose
  GPIO signals between a WisBlock Core module and a WisBlock Base board.

  This binding provides a nexus mapping for 25 logical pins where parent
  pin indices correspond to the WISBLOCK_IO_* constants defined in
  <zephyr/dt-bindings/gpio/wisblock-io-connector.h>:

    0   SW1       User button
    1   TXD0      UART0 TX
    2   RXD0      UART0 RX
    3   LED1      User LED 1
    4   LED2      User LED 2
    5   LED3      User LED 3
    6   I2C1_SDA  I2C bus 1 SDA
    7   I2C1_SCL  I2C bus 1 SCL
    8   AIN0      Analog input 0
    9   AIN1      Analog input 1
    10  IO7       General-purpose IO7
    11  SPI_CS    SPI chip select
    12  SPI_CLK   SPI clock
    13  SPI_MISO  SPI MISO
    14  SPI_MOSI  SPI MOSI
    15  IO1       General-purpose IO1
    16  IO2       General-purpose IO2
    17  IO3       General-purpose IO3
    18  IO4       General-purpose IO4
    19  TXD1      UART1 TX
    20  RXD1      UART1 RX
    21  I2C2_SDA  I2C bus 2 SDA
    22  I2C2_SCL  I2C bus 2 SCL
    23  IO5       General-purpose IO5
    24  IO6       General-purpose IO6

compatible: "wisblock-io-connector"

include: [gpio-nexus.yaml, base.yaml]
```

## dts/bindings/gpio/wisblock-slot-connector.yaml
```yaml
# Copyright (c) 2026 Shenzhen RAKwireless Technology Co., Ltd.
# SPDX-License-Identifier: Apache-2.0

description: |
  GPIO pins exposed on a WisBlock sensor slot connector.

  WisBlock Base boards provide between two and six sensor slots (A through F).
  Each slot carries a 10-pin board-to-board connector with a common pinout
  shared across all slot positions. This binding provides a nexus mapping for
  those 10 pins, where parent pin indices correspond to the WISBLOCK_SLOT_*
  constants defined in
  <zephyr/dt-bindings/gpio/wisblock-slot-connector.h>:

    0   TXD       UART TX
    1   SPI_CS    SPI chip select
    2   SPI_CLK   SPI clock
    3   SPI_MISO  SPI MISO
    4   SPI_MOSI  SPI MOSI
    5   I2C_SCL   I2C SCL
    6   I2C_SDA   I2C SDA
    7   GPIO1     General-purpose GPIO1
    8   GPIO2     General-purpose GPIO2
    9   RXD       UART RX

  Each WisBlock Base board instantiates one node per slot using this
  binding (e.g. wisblock_slota, wisblock_slotb, ...) and maps the logical
  slot pins to the underlying SoC GPIO lines via wisblock_io.

compatible: "wisblock-slot-connector"

include: [gpio-nexus.yaml, base.yaml]
```

## dts/bindings/pwm/wisblock-pwm.yaml
```yaml
# Copyright (c) 2026 Shenzhen RAKwireless Technology Co., Ltd.
# SPDX-License-Identifier: Apache-2.0

description: |
  PWM channels exposed on the WisBlock IO connector.

  WisBlock Core modules can expose PWM-capable lines through the WisBlock
  IO connector. This binding provides a nexus mapping where parent pin
  indices correspond to the WISBLOCK_PWM_* constants defined in
  <zephyr/dt-bindings/pwm/wisblock-pwm.h>:

    0   LED1  PWM channel routed to LED1
    1   IO1   PWM channel routed to IO1
    2   IO2   PWM channel routed to IO2
    3   IO3   PWM channel routed to IO3
    4   IO5   PWM channel routed to IO5
    5   IO6   PWM channel routed to IO6

  Example usage in a WisBlock Core board file:

    wisblock_pwm: wisblock-pwm {
      compatible = "wisblock-pwm";
      pwm-map = <0 0 0 &pwm0 0 0 0>,
                <1 0 0 &pwm0 1 0 0>;
      #pwm-cells = <3>;
    };

compatible: "wisblock-pwm"

include: [base.yaml, pwm-nexus.yaml]
```

## tests/boards/wisblock/io_contract/Kconfig
```kconfig
# SPDX-License-Identifier: Apache-2.0
# Copyright (c) 2026 Shenzhen RAKwireless Technology Co., Ltd.

config WISBLOCK_IO_TEST_UART0
	bool "Verify wisblock_uart0 optional bus"
	help
	  Enable build-time verification that wisblock_uart0 exists and is
	  enabled on the target board.

config WISBLOCK_IO_TEST_I2C2
	bool "Verify wisblock_i2c2 optional bus"
	help
	  Enable build-time verification that wisblock_i2c2 exists and is
	  enabled on the target board.

config WISBLOCK_IO_TEST_PDM
	bool "Verify wisblock_pdm optional bus"
	help
	  Enable build-time verification that wisblock_pdm exists and is
	  enabled on the target board.

source "Kconfig.zephyr"
```

## tests/boards/wisblock/io_contract/testcase.yaml
```yaml
# SPDX-License-Identifier: Apache-2.0
# Copyright (c) 2026 RAKwireless Technology Limited
#
# WisBlock IO interface contract validation.
# Verifies that each WisBlock Core module compiles correctly when combined with
# each WisBlock Base board shield.  The WisBlock IO connector is a vendor-neutral
# interface; any WisBlock Certified Core or Base board must satisfy this contract.

common:
  build_only: true
  tags:
    - wisblock

tests:
  boards.wisblock.io_contract:
    depends_on: wisblock
```
