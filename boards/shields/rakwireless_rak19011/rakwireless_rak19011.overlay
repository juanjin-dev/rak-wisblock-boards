/*
 * SPDX-License-Identifier: Apache-2.0
 * Copyright (c) 2026 RAKwireless Technology Limited
 */

#include <wisblock/wisblock_sensor_a.dtsi>
#include <wisblock/wisblock_sensor_b.dtsi>
#include <wisblock/wisblock_sensor_c.dtsi>
#include <wisblock/wisblock_sensor_d.dtsi>
#include <wisblock/wisblock_sensor_e.dtsi>
#include <wisblock/wisblock_sensor_f.dtsi>

#if defined(WISBLOCK_IO_HAS_SW1)
#include "rakwireless_rak19011_sw1.dtsi"
#endif /* WISBLOCK_IO_HAS_SW1 */