/*
 * SPDX-License-Identifier: Apache-2.0
 * Copyright (c) 2026 Shenzhen RAKwireless Technology Co., Ltd.
 */

#include "rakwireless_rak19011_common.dtsi"

#include <zephyr/dt-bindings/input/input-event-codes.h>

/ {
	aliases {
		sw0 = &wisblock_sw1;
	};

	rak19011_keys {
		compatible = "gpio-keys";

		wisblock_sw1: rak19011_sw1 {
			label = "SW1";
			gpios = <&wisblock_io WISBLOCK_IO_SW1 GPIO_ACTIVE_LOW>;
			zephyr,code = <INPUT_KEY_0>;
		};
	};
};
