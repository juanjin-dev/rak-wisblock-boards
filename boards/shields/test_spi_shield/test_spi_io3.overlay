/*
 * SPDX-License-Identifier: Apache-2.0
 * Copyright (c) 2026 Shenzhen RAKwireless Technology Co., Ltd.
 *
 * Test SPI CS accumulator shield: test_spi_io3
 */

#include <zephyr/dt-bindings/gpio/gpio.h>

#define WISBLOCK_SPI_USE_IO3
#define WISBLOCK_SPI_IO3_FLAGS (GPIO_ACTIVE_LOW)
#include <wisblock/wisblock_spi_cs.dtsi>

&wisblock_spi {
	status = "okay";
	cs-gpios = WISBLOCK_SPI_CS_GPIOS;

	test_dev_io3: spi_test@WISBLOCK_SPI_IO3_IDX {
		compatible = "jedec,spi-nor";
		reg = <WISBLOCK_SPI_IO3_REG>;
		spi-max-frequency = <1000000>;
		jedec-id = [ff ff ff];
		size = <DT_SIZE_K(512)>;
		status = "okay";
	};
};
