/*
 * SPDX-License-Identifier: Apache-2.0
 * Copyright (c) 2026 Shenzhen RAKwireless Technology Co., Ltd.
 *
 * Test SPI CS accumulator shield: test_spi_slotc_2
 */

#include <zephyr/dt-bindings/gpio/gpio.h>

#define WISBLOCK_SPI_USE_SLOTC_GPIO2
#define WISBLOCK_SPI_SLOTC_GPIO2_FLAGS (GPIO_ACTIVE_LOW)
#include <wisblock/wisblock_spi_cs.dtsi>

&wisblock_spi {
	status = "okay";
	cs-gpios = WISBLOCK_SPI_CS_GPIOS;

	test_dev_slotc_2: spi_test@WISBLOCK_SPI_SLOTC_GPIO2_IDX {
		compatible = "jedec,spi-nor";
		reg = <WISBLOCK_SPI_SLOTC_GPIO2_REG>;
		spi-max-frequency = <1000000>;
		jedec-id = [ff ff ff];
		size = <DT_SIZE_K(512)>;
		status = "okay";
	};
};
